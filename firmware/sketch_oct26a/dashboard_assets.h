#pragma once
#include <pgmspace.h>

static const char DASHBOARD_HTML[] PROGMEM = R"PMHTML(<!doctype html>
<html lang="en">
  <head>
    <meta charset="utf-8">
    <meta name="viewport" content="width=device-width, initial-scale=1, viewport-fit=cover">
    <meta name="theme-color" content="#10191b">
    <meta name="description" content="Live temperature and humidity monitoring for a poultry house.">
    <meta name="apple-mobile-web-app-capable" content="yes">
    <meta name="apple-mobile-web-app-status-bar-style" content="black-translucent">
    <title>Poultry House Monitor</title>
    <link rel="manifest" href="manifest.webmanifest">
    <link rel="apple-touch-icon" href="app-icon-192.png">
    <link rel="stylesheet" href="styles.css">
    <script src="cloud-config.js" defer></script>
    <script src="app.js" defer></script>
  </head>
  <body>
    <svg class="icon-library" xmlns="http://www.w3.org/2000/svg" aria-hidden="true">
      <symbol id="icon-grid" viewBox="0 0 24 24"><rect x="3" y="3" width="7" height="7" rx="2"/><rect x="14" y="3" width="7" height="7" rx="2"/><rect x="3" y="14" width="7" height="7" rx="2"/><rect x="14" y="14" width="7" height="7" rx="2"/></symbol>
      <symbol id="icon-weather" viewBox="0 0 24 24"><path d="M7 18h10a4 4 0 0 0 .4-8A6 6 0 0 0 6 11a3.5 3.5 0 0 0 1 7Z"/><path d="M8 21v-1m4 1v-1m4 1v-1"/></symbol>
      <symbol id="icon-history" viewBox="0 0 24 24"><path d="M3 12a9 9 0 1 0 2.6-6.4L3 8"/><path d="M3 3v5h5m4-1v5l3 2"/></symbol>
      <symbol id="icon-settings" viewBox="0 0 24 24"><path d="M12 8.5a3.5 3.5 0 1 0 0 7 3.5 3.5 0 0 0 0-7Z"/><path d="m19.4 15 .1.1 1.1.9-1.2 2.1-1.4-.5a8 8 0 0 1-1.5.9l-.2 1.5h-2.5l-.3-1.5a8 8 0 0 1-1.6-.9l-1.4.5-1.2-2.1 1.2-1a7 7 0 0 1 0-1.8l-1.2-1 1.2-2.1 1.4.5a8 8 0 0 1 1.6-.9l.3-1.5h2.5l.2 1.5a8 8 0 0 1 1.5.9l1.4-.5 1.2 2.1-1.1 1a7 7 0 0 1-.1 1.8Z" transform="translate(-1 -1) scale(1.08)"/></symbol>
      <symbol id="icon-thermometer" viewBox="0 0 24 24"><path d="M14 14.8V5a3 3 0 0 0-6 0v9.8a5 5 0 1 0 6 0Z"/><path d="M11 12V5"/></symbol>
      <symbol id="icon-drop" viewBox="0 0 24 24"><path d="M12 3s7 7.2 7 12a7 7 0 0 1-14 0c0-4.8 7-12 7-12Z"/><path d="M9 16a3 3 0 0 0 3 3"/></symbol>
      <symbol id="icon-wifi" viewBox="0 0 24 24"><path d="M3 9a14 14 0 0 1 18 0M6.5 12.5a9 9 0 0 1 11 0M10 16a4 4 0 0 1 4 0"/><circle cx="12" cy="19" r="1"/></symbol>
      <symbol id="icon-refresh" viewBox="0 0 24 24"><path d="M20 7v5h-5M4 17v-5h5"/><path d="M5.5 9A7 7 0 0 1 18 6l2 2M4 16l2 2a7 7 0 0 0 12.5-3"/></symbol>
      <symbol id="icon-arrow" viewBox="0 0 24 24"><path d="M5 12h14m-6-6 6 6-6 6"/></symbol>
      <symbol id="icon-clock" viewBox="0 0 24 24"><circle cx="12" cy="12" r="9"/><path d="M12 7v5l3 2"/></symbol>
      <symbol id="icon-check" viewBox="0 0 24 24"><path d="m5 12 4 4L19 6"/></symbol>
      <symbol id="icon-alert" viewBox="0 0 24 24"><path d="M12 3 2.8 19h18.4L12 3Z"/><path d="M12 9v4m0 3h.01"/></symbol>
    </svg>

    <div class="app-shell">
      <aside class="sidebar" aria-label="Main navigation">
        <a class="brand" href="#home" data-page-link="home" aria-label="Poultry House Monitor home">
          <span class="brand-mark"><span></span><span></span><span></span></span>
          <span class="brand-copy"><strong>coop<span>care</span></strong><small>HOUSE MONITOR</small></span>
        </a>
        <div class="side-label">MONITORING</div>
        <nav class="side-nav">
          <button class="nav-link active" type="button" data-page="home"><svg><use href="#icon-grid"></use></svg><span>Overview</span></button>
          <button class="nav-link" type="button" data-page="climate"><svg><use href="#icon-weather"></use></svg><span>Climate</span></button>
          <button class="nav-link" type="button" data-page="history"><svg><use href="#icon-history"></use></svg><span>History</span></button>
        </nav>
        <div class="side-label side-label-settings">PREFERENCES</div>
        <nav class="side-nav">
          <button class="nav-link" type="button" data-page="settings"><svg><use href="#icon-settings"></use></svg><span>Settings</span></button>
        </nav>
        <div class="sidebar-bottom">
          <div class="mini-connection"><span class="status-dot"></span><span><strong id="sidebar-status">Connecting</strong><small id="sidebar-address">192.168.4.1</small></span></div>
          <div class="sidebar-foot">ESP32-S3 <span>·</span> DHT22</div>
        </div>
      </aside>

      <main class="main-content">
        <header class="topbar">
          <div class="mobile-brand">
            <span class="brand-mark"><span></span><span></span><span></span></span>
            <span class="brand-copy"><strong>coop<span>care</span></strong><small>HOUSE MONITOR</small></span>
          </div>
          <div class="page-heading">
            <p class="eyebrow">POULTRY HOUSE <span class="eyebrow-separator">/</span> <span id="heading-section">OVERVIEW</span></p>
            <h1 id="page-title">Good day, caretaker <span class="wave">✳</span></h1>
          </div>
          <div class="topbar-actions">
            <span class="last-updated"><span class="status-dot"></span><span id="updated-label">Waiting for readings</span></span>
            <button class="icon-button" id="refresh-button" type="button" aria-label="Refresh sensor data" title="Refresh now"><svg><use href="#icon-refresh"></use></svg></button>
          </div>
        </header>

        <div class="connection-banner" id="connection-banner" role="status">
          <span class="banner-icon"><svg><use href="#icon-wifi"></use></svg></span>
          <span class="banner-copy"><strong id="connection-title">Connecting to your monitor</strong><small id="connection-message">Connect directly to your ESP32 over Bluetooth for live readings.</small><button class="bluetooth-connect-button" id="bluetooth-connect-button" type="button">Connect ESP32 via Bluetooth</button><button class="stop-warning-button" id="stop-warning-button" type="button" hidden>Stop hardware alarm</button><small class="warning-action-message" id="warning-action-message" aria-live="polite"></small></span>
          <span class="banner-state" id="connection-state">CONNECTING</span>
        </div>

        <section class="page-panel active" id="page-home" data-page-panel="home">
          <div class="section-intro">
            <div><p class="eyebrow">LIVE CONDITIONS</p><h2>Your house at a glance</h2></div>
            <span class="update-chip"><span class="pulse-dot"></span> AUTO-REFRESH · 3 SEC</span>
          </div>
          <div class="metric-grid">
            <article class="metric-card temperature-card">
              <div class="metric-topline"><span class="metric-icon"><svg><use href="#icon-thermometer"></use></svg></span><span class="metric-category">AIR TEMPERATURE</span><span class="metric-live">LIVE</span></div>
              <div class="metric-value"><span id="temperature-value">--.-</span><span class="metric-unit">°C</span></div>
              <div class="metric-footer"><span class="metric-caption">Inside poultry house</span><span class="metric-indicator" id="temperature-condition">Waiting for data</span></div>
              <div class="metric-decoration temperature-decoration"></div>
            </article>
            <article class="metric-card humidity-card">
              <div class="metric-topline"><span class="metric-icon"><svg><use href="#icon-drop"></use></svg></span><span class="metric-category">RELATIVE HUMIDITY</span><span class="metric-live">LIVE</span></div>
              <div class="metric-value"><span id="humidity-value">--.-</span><span class="metric-unit">%</span></div>
              <div class="metric-footer"><span class="metric-caption">Moisture in the air</span><span class="metric-indicator" id="humidity-condition">Waiting for data</span></div>
              <div class="metric-decoration humidity-decoration"></div>
            </article>
          </div>

          <div class="overview-grid">
            <article class="panel sensor-panel">
              <div class="panel-heading"><div><p class="eyebrow">HARDWARE</p><h3>Sensor health</h3></div><span class="health-icon" id="sensor-health-icon"><svg><use href="#icon-check"></use></svg></span></div>
              <div class="sensor-health-row"><div class="sensor-symbol"><svg><use href="#icon-thermometer"></use></svg></div><div class="sensor-info"><strong>DHT22 sensor</strong><small>Temperature & humidity</small></div><span class="health-pill" id="sensor-health-pill">CHECKING</span></div>
              <div class="sensor-health-row"><div class="sensor-symbol wifi-symbol"><svg><use href="#icon-wifi"></use></svg></div><div class="sensor-info"><strong>ESP32-S3</strong><small id="device-address-label">192.168.4.1</small></div><span class="health-pill" id="device-health-pill">CHECKING</span></div>
              <div class="panel-note"><span class="note-mark">i</span><span>Local Wi-Fi connection only. Internet access is not provided by the ESP32.</span></div>
            </article>

            <article class="panel recent-panel">
              <div class="panel-heading"><div><p class="eyebrow">DEVICE LOG</p><h3>Recent readings</h3></div><button class="text-button" type="button" data-page="history">View history <svg><use href="#icon-arrow"></use></svg></button></div>
              <div class="recent-list" id="recent-list"><div class="empty-state">Your recent readings will appear here when the monitor connects.</div></div>
            </article>
          </div>
          <footer class="page-footer">Designed for calm, healthy poultry houses <span>·</span> Read-only environmental monitoring</footer>
        </section>

        <section class="page-panel" id="page-climate" data-page-panel="climate" hidden>
          <div class="section-intro"><div><p class="eyebrow">ENVIRONMENT</p><h2>House climate</h2><p class="section-description">A clear look at the current conditions reported by your DHT22 sensor.</p></div></div>
          <div class="metric-grid climate-metrics">
            <article class="metric-card temperature-card"><div class="metric-topline"><span class="metric-icon"><svg><use href="#icon-thermometer"></use></svg></span><span class="metric-category">TEMPERATURE</span></div><div class="metric-value"><span id="climate-temperature-value">--.-</span><span class="metric-unit">°C</span></div><div class="climate-meter"><span id="temperature-meter"></span></div><div class="metric-footer"><span class="metric-caption">Measured inside the house</span><span class="metric-indicator" id="climate-temperature-condition">Waiting for data</span></div></article>
            <article class="metric-card humidity-card"><div class="metric-topline"><span class="metric-icon"><svg><use href="#icon-drop"></use></svg></span><span class="metric-category">RELATIVE HUMIDITY</span></div><div class="metric-value"><span id="climate-humidity-value">--.-</span><span class="metric-unit">%</span></div><div class="climate-meter"><span id="humidity-meter"></span></div><div class="metric-footer"><span class="metric-caption">Measured inside the house</span><span class="metric-indicator" id="climate-humidity-condition">Waiting for data</span></div></article>
          </div>
          <article class="panel climate-note"><span class="note-mark">i</span><div><h3>Monitoring, not automation</h3><p>This dashboard reports temperature and relative humidity only. It does not control fans, heaters, or ventilation. Use your project’s validated thresholds when assessing readings.</p></div></article>
          <div class="climate-updated"><svg><use href="#icon-clock"></use></svg><span id="climate-updated-label">Waiting for the first successful reading</span></div>
        </section>

        <section class="page-panel" id="page-history" data-page-panel="history" hidden>
          <div class="section-intro history-heading"><div><p class="eyebrow">SAVED IN LOCAL SQL</p><h2>Sensor history</h2><p class="section-description">Readings saved by the local dashboard server, with the time they were received.</p></div><span class="record-count" id="record-count">0 <small>records</small></span></div>
          <article class="panel chart-panel"><div class="panel-heading"><div><p class="eyebrow">TEMPERATURE SNAPSHOT</p><h3>Recent temperature trend</h3></div><span class="chart-unit">°C</span></div><div class="bar-chart" id="history-chart"><div class="chart-empty">The chart appears after sensor readings are saved in the local SQL database.</div></div><div class="chart-legend"><span><i></i>Temperature</span><span>Latest SQL records</span></div></article>
          <article class="panel history-panel"><div class="panel-heading"><div><p class="eyebrow">ALL READINGS</p><h3>History log</h3></div><span class="table-refresh">Updates with sensor refresh</span></div><div class="history-list" id="history-list"><div class="empty-state">No history records available.</div></div></article>
          <div class="history-disclaimer"><span class="note-mark">i</span> Records are stored on the computer running this dashboard server. They are separate from the ESP32’s own history.</div>
        </section>

        <section class="page-panel settings-panel" id="page-settings" data-page-panel="settings" hidden>
          <div class="section-intro"><div><p class="eyebrow">PREFERENCES</p><h2>Monitor settings</h2><p class="section-description">Use Bluetooth for direct phone-to-monitor readings without joining a Wi-Fi network.</p></div></div>
          <article class="panel settings-card theme-card"><div class="panel-heading"><div><p class="eyebrow">APPEARANCE</p><h3>Display theme</h3></div><span class="settings-icon"><svg><use href="#icon-settings"></use></svg></span></div>
            <div class="theme-setting"><div class="theme-setting-copy"><strong>Dark mode</strong><small>Choose the look that feels comfortable for you.</small></div><label class="theme-switch"><input id="dark-mode-toggle" type="checkbox" role="switch" aria-label="Dark mode"><span class="switch-track" aria-hidden="true"><span></span></span><span class="switch-label" id="theme-mode-label">On</span></label></div>
            <p class="form-message" id="theme-message" role="status" aria-live="polite"></p>
          </article>
          <article class="panel settings-card app-install-card">
            <div class="panel-heading"><div><p class="eyebrow">APP</p><h3>Install on your device</h3></div><span class="settings-icon"><svg><use href="#icon-grid"></use></svg></span></div>
            <p class="install-description">Add Coop Care to your home screen for quick access. Open it over HTTPS, then connect to the ESP32 with Bluetooth.</p>
            <button class="save-button install-button" id="install-button" type="button">Install app</button>
            <p class="form-message install-message" id="install-message" role="status" aria-live="polite">If there is no install prompt, use your browser menu: Install app or Add to Home Screen.</p>
          </article>
          <article class="panel settings-card"><div class="panel-heading"><div><p class="eyebrow">OPTIONAL WI-FI</p><h3>ESP32 address</h3></div><span class="settings-icon"><svg><use href="#icon-wifi"></use></svg></span></div>
            <form id="settings-form" novalidate><label class="field-label" for="device-url">Device base URL</label><div class="input-wrap"><span class="input-prefix"><svg><use href="#icon-wifi"></use></svg></span><input id="device-url" name="deviceUrl" type="url" inputmode="url" autocomplete="url" placeholder="http://192.168.4.1" spellcheck="false" required><button class="save-button" id="save-button" type="submit">Save & connect <svg><use href="#icon-arrow"></use></svg></button></div><p class="field-help">Wi-Fi is optional. For Bluetooth, use the button on the Home screen and keep phone Wi-Fi off.</p><p class="form-message" id="settings-message" role="status"></p></form>
          </article>
          <article class="panel diagnostics-card" aria-live="polite">
            <div class="panel-heading"><div><p class="eyebrow">LIVE CHECK</p><h3>Connection diagnostics</h3></div><span class="diagnostics-updated" id="diagnostic-attempt">Not checked yet</span></div>
            <dl class="diagnostics-list">
              <div><dt>ESP32 status endpoint</dt><dd id="diagnostic-status-api">Waiting</dd></div>
              <div><dt>Local SQL history endpoint</dt><dd id="diagnostic-history-api">Waiting</dd></div>
              <div><dt>Last successful reading</dt><dd id="diagnostic-last-reading">No reading received yet</dd></div>
              <div class="diagnostic-error-row" id="diagnostic-error-row" hidden><dt>Latest issue</dt><dd id="diagnostic-error"></dd></div>
            </dl>
            <p class="diagnostics-help">Bluetooth mode provides live readings without Wi-Fi, but does not sync history to the cloud. The phone needs mobile data to open GitHub Pages; Bluetooth connects it directly to the ESP32.</p>
          </article>
          <article class="panel instructions-card"><div class="panel-heading"><div><p class="eyebrow">GETTING CONNECTED</p><h3>Connect directly with Bluetooth</h3></div></div><ol class="setup-steps"><li><span>01</span><div><strong>Open this dashboard in Android Chrome</strong><p>Use the GitHub Pages link over HTTPS. Mobile data can stay on; Wi-Fi and hotspot are not needed.</p></div></li><li><span>02</span><div><strong>Connect to PoultryMonitor</strong><p>Tap <b>Connect ESP32 via Bluetooth</b> on the Home screen and choose the monitor when Chrome asks.</p></div></li><li><span>03</span><div><strong>Keep Bluetooth on</strong><p>Live readings update on this dashboard. Bluetooth mode does not send readings to cloud history.</p></div></li></ol></article>
          <article class="panel limitation-card"><span class="note-mark">i</span><div><h3>Bluetooth is local-only</h3><p>Bluetooth sends live readings directly from the ESP32 to this phone. It does not need Wi-Fi, a hotspot, or internet after the dashboard is loaded, but cloud history requires the ESP32 to have its own internet connection.</p></div></article>
        </section>

        <nav class="mobile-nav" aria-label="Main navigation">
          <button class="mobile-nav-link active" type="button" data-page="home"><svg><use href="#icon-grid"></use></svg><span>Home</span></button>
          <button class="mobile-nav-link" type="button" data-page="climate"><svg><use href="#icon-weather"></use></svg><span>Climate</span></button>
          <button class="mobile-nav-link" type="button" data-page="history"><svg><use href="#icon-history"></use></svg><span>History</span></button>
          <button class="mobile-nav-link" type="button" data-page="settings"><svg><use href="#icon-settings"></use></svg><span>Settings</span></button>
        </nav>
      </main>
    </div>
  </body>
</html>
)PMHTML";

static const char DASHBOARD_CSS[] PROGMEM = R"PMCSS(:root {
  color-scheme: dark;
  --canvas: #10191b;
  --surface: #172326;
  --surface-raised: #1d2d30;
  --surface-soft: #263a3d;
  --sidebar: #122023;
  --border: rgba(211, 238, 233, .1);
  --text: #eaf4f2;
  --muted: #b2c7c3;
  --faint: #839b97;
  --lime: #68d9c3;
  --lime-rgb: 104, 217, 195;
  --lime-dark: #318f82;
  --orange: #ff9a72;
  --orange-rgb: 255, 154, 114;
  --blue: #86bce8;
  --blue-rgb: 134, 188, 232;
  --danger: #ff827d;
  --danger-rgb: 255, 130, 125;
  --ok: #65d5a2;
  --ok-rgb: 101, 213, 162;
  --warning: #f2c66d;
  --warning-rgb: 242, 198, 109;
  --accent-contrast: #12312d;
  --hover-rgb: 255, 255, 255;
  font-family: 'Segoe UI', Arial, sans-serif;
  font-synthesis: none;
  text-rendering: optimizeLegibility;
}

:root[data-theme="light"] {
  color-scheme: light;
  --canvas: #f0f7f5;
  --surface: #fbfefd;
  --surface-raised: #f3faf8;
  --surface-soft: #e6f1ee;
  --sidebar: #f8fcfa;
  --border: rgba(30, 75, 68, .14);
  --text: #1b302d;
  --muted: #526c67;
  --faint: #728984;
  --lime: #087f73;
  --lime-rgb: 8, 127, 115;
  --lime-dark: #17675f;
  --orange: #b9512e;
  --orange-rgb: 185, 81, 46;
  --blue: #316f9f;
  --blue-rgb: 49, 111, 159;
  --danger: #b54547;
  --danger-rgb: 181, 69, 71;
  --ok: #24734f;
  --ok-rgb: 36, 115, 79;
  --warning: #805200;
  --warning-rgb: 128, 82, 0;
  --accent-contrast: #ffffff;
  --hover-rgb: 17, 68, 61;
}

* { box-sizing: border-box; }

body {
  margin: 0;
  min-width: 320px;
  min-height: 100vh;
  background:
    radial-gradient(ellipse at 75% -20%, rgba(var(--lime-rgb), .12), transparent 42%),
    var(--canvas);
  color: var(--text);
  transition: background-color .2s ease, color .2s ease;
}

:root[data-theme="light"] body {
  background:
    radial-gradient(ellipse at 75% -20%, rgba(var(--lime-rgb), .1), transparent 42%),
    var(--canvas);
}

button, input { font: inherit; }
button { color: inherit; }
.icon-library { position: absolute; width: 0; height: 0; overflow: hidden; }
svg { width: 20px; height: 20px; fill: none; stroke: currentColor; stroke-width: 1.8; stroke-linecap: round; stroke-linejoin: round; }

.app-shell { min-height: 100vh; }
.sidebar {
  position: fixed;
  inset: 0 auto 0 0;
  z-index: 5;
  display: flex;
  width: 248px;
  flex-direction: column;
  padding: 31px 18px 22px;
  border-right: 1px solid var(--border);
  background: var(--sidebar);
}

:root[data-theme="light"] .sidebar,
:root[data-theme="light"] .mobile-nav { background: var(--sidebar); }

.brand, .mobile-brand { display: inline-flex; align-items: center; gap: 12px; text-decoration: none; color: var(--text); }
.brand { padding: 0 10px 49px; }
.brand-mark { width: 35px; height: 35px; display: inline-flex; align-items: flex-end; justify-content: center; gap: 3px; padding: 7px; border-radius: 12px; background: var(--lime); transform: rotate(-3deg); }
.brand-mark span { width: 5px; border-radius: 4px; background: var(--accent-contrast); transform: rotate(3deg); }
.brand-mark span:nth-child(1) { height: 12px; }
.brand-mark span:nth-child(2) { height: 19px; }
.brand-mark span:nth-child(3) { height: 15px; }
.brand-copy { display: grid; gap: 1px; }
.brand-copy strong { font: 800 20px/1 'Segoe UI', Arial, sans-serif; letter-spacing: -1px; }
.brand-copy strong span { color: var(--lime); }
.brand-copy small { color: var(--faint); font-size: 8px; font-weight: 700; letter-spacing: 1.65px; }
.side-label, .eyebrow { color: var(--faint); font-size: 9px; font-weight: 700; letter-spacing: 1.65px; }
.side-label { padding: 0 12px 10px; }
.side-label-settings { margin-top: 31px; }
.side-nav { display: grid; gap: 5px; }
.nav-link { display: flex; align-items: center; gap: 13px; width: 100%; padding: 12px; border: 0; border-radius: 11px; background: transparent; color: var(--muted); text-align: left; cursor: pointer; transition: background .2s, color .2s; }
.nav-link svg { width: 18px; height: 18px; }
.nav-link:hover { background: rgba(var(--hover-rgb), .05); color: var(--text); }
.nav-link.active { background: rgba(var(--lime-rgb), .13); color: var(--lime); }
.nav-link span { font-size: 13px; font-weight: 600; }
.sidebar-bottom { margin-top: auto; }
.mini-connection { display: flex; align-items: center; gap: 10px; margin: 0 3px; padding: 14px 12px; border: 1px solid var(--border); border-radius: 12px; background: rgba(255,255,255,.02); }
.status-dot, .pulse-dot { display: inline-block; flex: 0 0 auto; width: 7px; height: 7px; border-radius: 50%; background: var(--warning); }
.status-dot.connected { background: var(--ok); box-shadow: 0 0 12px rgba(var(--ok-rgb), .4); }
.status-dot.warning { background: var(--warning); box-shadow: 0 0 12px rgba(var(--warning-rgb), .35); }
.status-dot.error { background: var(--danger); }
.mini-connection strong, .mini-connection small { display: block; }
.mini-connection strong { font-size: 11px; }
.mini-connection small { margin-top: 2px; color: var(--faint); font-size: 10px; }
.sidebar-foot { padding: 17px 12px 0; color: var(--faint); font-size: 10px; }
.sidebar-foot span { padding: 0 4px; color: var(--lime-dark); }

.main-content { max-width: 1600px; min-height: 100vh; margin-left: 248px; padding: 0 46px 28px; }
.topbar { min-height: 110px; display: flex; align-items: center; justify-content: space-between; gap: 20px; border-bottom: 1px solid var(--border); }
.mobile-brand { display: none; }
.page-heading .eyebrow { margin: 0 0 7px; font-size: 8px; }
.eyebrow-separator { padding: 0 7px; color: var(--blue); }
h1, h2, h3, p { margin-top: 0; }
h1 { margin-bottom: 0; font: 700 20px/1.3 'Segoe UI', Arial, sans-serif; letter-spacing: -.5px; }
.wave { color: var(--lime); font-size: 17px; }
.topbar-actions { display: flex; align-items: center; gap: 17px; }
.last-updated { display: inline-flex; align-items: center; gap: 8px; color: var(--muted); font-size: 10px; white-space: nowrap; }
.last-updated .status-dot { width: 6px; height: 6px; background: var(--lime); }
.last-updated.is-stale { color: var(--warning); }
.last-updated.is-stale .status-dot { background: var(--warning); }
.icon-button { display: grid; width: 39px; height: 39px; place-items: center; border: 1px solid var(--border); border-radius: 12px; background: var(--surface); color: var(--muted); cursor: pointer; }
.icon-button:hover { border-color: rgba(var(--lime-rgb), .4); color: var(--lime); }
.icon-button svg { width: 17px; height: 17px; }
.icon-button.busy svg { animation: spin 1s linear infinite; }
@keyframes spin { to { transform: rotate(360deg); } }

.connection-banner { display: flex; align-items: center; gap: 13px; margin-top: 23px; padding: 13px 15px; border: 1px solid rgba(var(--warning-rgb), .14); border-radius: 13px; background: rgba(var(--warning-rgb), .045); }
.connection-banner.is-connected { border-color: rgba(var(--ok-rgb), .2); background: rgba(var(--ok-rgb), .06); }
.connection-banner.is-warning { border-color: rgba(var(--warning-rgb), .28); background: rgba(var(--warning-rgb), .08); }
.connection-banner.is-error { border-color: rgba(var(--danger-rgb), .2); background: rgba(var(--danger-rgb), .05); }
.banner-icon { display: grid; width: 34px; height: 34px; flex: 0 0 auto; place-items: center; border-radius: 10px; background: rgba(var(--warning-rgb), .1); color: var(--warning); }
.is-connected .banner-icon { background: rgba(var(--ok-rgb), .12); color: var(--ok); }
.is-warning .banner-icon { background: rgba(var(--warning-rgb), .14); color: var(--warning); }
.is-error .banner-icon { background: rgba(var(--danger-rgb), .1); color: var(--danger); }
.banner-icon svg { width: 17px; height: 17px; }
.banner-copy { display: grid; gap: 3px; min-width: 0; }
.banner-copy strong { font-size: 11px; font-weight: 700; }
.banner-copy small { overflow: hidden; color: var(--muted); font-size: 10px; text-overflow: ellipsis; white-space: nowrap; }
.bluetooth-connect-button { justify-self: start; margin-top: 5px; padding: 7px 10px; border: 1px solid rgba(var(--blue-rgb), .35); border-radius: 7px; background: rgba(var(--blue-rgb), .12); color: var(--blue); font-size: 10px; font-weight: 700; cursor: pointer; }
.bluetooth-connect-button:hover:not(:disabled) { background: rgba(var(--blue-rgb), .2); }
.bluetooth-connect-button:disabled { cursor: default; opacity: .7; }
.stop-warning-button { justify-self: start; margin-top: 5px; padding: 6px 9px; border: 1px solid rgba(var(--warning-rgb), .32); border-radius: 7px; background: rgba(var(--warning-rgb), .12); color: var(--warning); font-size: 9px; font-weight: 700; cursor: pointer; }
.stop-warning-button:hover:not(:disabled) { background: rgba(var(--warning-rgb), .2); }
.stop-warning-button:disabled { cursor: default; opacity: .7; }
.banner-copy .warning-action-message:not(:empty) { white-space: normal; }
.banner-state { margin-left: auto; color: var(--warning); font-size: 8px; font-weight: 700; letter-spacing: 1.1px; white-space: nowrap; }
.is-connected .banner-state { color: var(--ok); }
.is-warning .banner-state { color: var(--warning); }
.is-error .banner-state { color: var(--danger); }

.page-panel { display: none; padding-top: 31px; animation: appear .24s ease-out; }
.page-panel.active { display: block; }
.page-panel[hidden] { display: none !important; }
@keyframes appear { from { opacity: 0; transform: translateY(4px); } to { opacity: 1; transform: translateY(0); } }
.section-intro { display: flex; align-items: flex-end; justify-content: space-between; gap: 16px; margin-bottom: 18px; }
.section-intro .eyebrow, .panel-heading .eyebrow { margin-bottom: 7px; }
h2 { margin-bottom: 0; font: 700 21px/1.35 'Segoe UI', Arial, sans-serif; letter-spacing: -.55px; }
.section-description { max-width: 570px; margin: 7px 0 0; color: var(--muted); font-size: 12px; line-height: 1.65; }
.update-chip { display: inline-flex; align-items: center; gap: 8px; padding: 7px 10px; border: 1px solid rgba(var(--lime-rgb), .2); border-radius: 7px; color: var(--lime); font-size: 8px; font-weight: 700; letter-spacing: .9px; white-space: nowrap; }
.pulse-dot { width: 6px; height: 6px; background: var(--lime); animation: pulse 1.7s ease-out infinite; }
@keyframes pulse { 50% { box-shadow: 0 0 0 5px rgba(var(--lime-rgb), .12); } }

.metric-grid { display: grid; grid-template-columns: repeat(2, minmax(0, 1fr)); gap: 17px; }
.metric-card { position: relative; min-height: 187px; overflow: hidden; padding: 19px 21px 17px; border: 1px solid var(--border); border-radius: 16px; background: var(--surface); }
.metric-topline { position: relative; z-index: 1; display: flex; align-items: center; gap: 10px; }
.metric-icon { display: grid; width: 32px; height: 32px; place-items: center; border-radius: 10px; }
.metric-icon svg { width: 17px; height: 17px; }
.temperature-card .metric-icon { background: rgba(var(--orange-rgb), .13); color: var(--orange); }
.humidity-card .metric-icon { background: rgba(var(--blue-rgb), .12); color: var(--blue); }
.metric-category { color: var(--muted); font-size: 8px; font-weight: 700; letter-spacing: 1.15px; }
.metric-live { margin-left: auto; padding: 5px 7px; border-radius: 5px; background: rgba(var(--lime-rgb), .14); color: var(--lime); font-size: 7px; font-weight: 700; letter-spacing: .8px; }
.metric-value { position: relative; z-index: 1; display: flex; align-items: baseline; gap: 7px; margin: 21px 0 13px; font: 700 clamp(38px, 5vw, 51px)/1 'Segoe UI', Arial, sans-serif; letter-spacing: -2.7px; }
.temperature-card .metric-value { color: var(--orange); }
.humidity-card .metric-value { color: var(--blue); }
.metric-unit { color: var(--muted); font: 500 16px 'Segoe UI', Arial, sans-serif; letter-spacing: 0; }
.metric-footer { position: relative; z-index: 1; display: flex; align-items: center; justify-content: space-between; gap: 8px; }
.metric-caption { color: var(--muted); font-size: 10px; }
.metric-indicator { color: var(--faint); font-size: 9px; font-weight: 600; text-align: right; }
.temperature-card .metric-indicator[data-level="normal"] { color: var(--orange); }
.humidity-card .metric-indicator[data-level="normal"] { color: var(--blue); }
.metric-decoration { position: absolute; right: -24px; bottom: -66px; width: 176px; height: 130px; border: 1px solid currentColor; border-radius: 50%; opacity: .14; }
.metric-decoration::before, .metric-decoration::after { position: absolute; inset: 13px; border: 1px solid currentColor; border-radius: 50%; content: ''; }
.metric-decoration::after { inset: 28px; }
.temperature-decoration { color: var(--orange); transform: rotate(-26deg); }
.humidity-decoration { color: var(--blue); transform: rotate(30deg) scale(1.06); }

.overview-grid { display: grid; grid-template-columns: minmax(260px, .82fr) minmax(0, 1.18fr); gap: 17px; margin-top: 18px; }
.panel { border: 1px solid var(--border); border-radius: 15px; background: var(--surface); }
.sensor-panel, .recent-panel { min-height: 237px; padding: 18px; }
.panel-heading { display: flex; align-items: center; justify-content: space-between; gap: 12px; }
.panel-heading .eyebrow { font-size: 8px; }
h3 { margin-bottom: 0; font: 700 14px/1.4 'Segoe UI', Arial, sans-serif; }
.health-icon, .settings-icon { display: grid; width: 30px; height: 30px; place-items: center; border-radius: 9px; background: rgba(var(--ok-rgb), .12); color: var(--ok); }
.health-icon svg { width: 16px; height: 16px; }
.sensor-health-row { display: flex; align-items: center; gap: 10px; padding: 13px 0; border-bottom: 1px solid var(--border); }
.sensor-symbol { display: grid; width: 31px; height: 31px; flex: 0 0 auto; place-items: center; border-radius: 9px; background: rgba(var(--orange-rgb), .12); color: var(--orange); }
.sensor-symbol svg { width: 16px; height: 16px; }
.wifi-symbol { background: rgba(var(--blue-rgb), .1); color: var(--blue); }
.sensor-info { min-width: 0; }
.sensor-info strong, .sensor-info small { display: block; overflow: hidden; text-overflow: ellipsis; white-space: nowrap; }
.sensor-info strong { font-size: 10px; }
.sensor-info small { margin-top: 3px; color: var(--faint); font-size: 9px; }
.health-pill { margin-left: auto; padding: 5px 7px; border-radius: 5px; background: rgba(var(--warning-rgb), .1); color: var(--warning); font-size: 7px; font-weight: 700; letter-spacing: .6px; white-space: nowrap; }
.health-pill.online { background: rgba(var(--ok-rgb), .12); color: var(--ok); }
.health-pill.warning { background: rgba(var(--warning-rgb), .14); color: var(--warning); }
.health-pill.offline { background: rgba(var(--danger-rgb), .1); color: var(--danger); }
.panel-note { display: flex; align-items: flex-start; gap: 9px; margin-top: 13px; color: var(--muted); font-size: 9px; line-height: 1.55; }
.note-mark { display: inline-grid; width: 15px; height: 15px; flex: 0 0 auto; place-items: center; border: 1px solid rgba(var(--lime-rgb), .4); border-radius: 50%; color: var(--lime); font: 700 9px Georgia, serif; }
.text-button { display: inline-flex; align-items: center; gap: 4px; border: 0; background: none; color: var(--lime); font-size: 9px; cursor: pointer; }
.text-button svg { width: 13px; height: 13px; }
.recent-list { margin-top: 15px; }
.recent-item { display: flex; align-items: center; gap: 10px; padding: 10px 0; border-bottom: 1px solid var(--border); }
.recent-item:last-child { border-bottom: 0; }
.recent-number { display: grid; width: 25px; height: 25px; flex: 0 0 auto; place-items: center; border-radius: 8px; background: var(--surface-soft); color: var(--lime); font-size: 9px; font-weight: 700; }
.recent-values { display: flex; flex: 1; align-items: center; gap: 13px; }
.recent-values strong { font-size: 10px; font-weight: 600; }
.recent-values .temp { color: var(--orange); }
.recent-values .hum { color: var(--blue); }
.recent-time { color: var(--faint); font-size: 8px; white-space: nowrap; }
.empty-state { padding: 22px 10px; color: var(--faint); font-size: 10px; line-height: 1.6; text-align: center; }
.page-footer { padding: 22px 4px 6px; color: var(--faint); font-size: 9px; text-align: center; }
.page-footer span { padding: 0 5px; color: var(--lime-dark); }

.climate-metrics { margin-bottom: 18px; }
.climate-metrics .metric-card { min-height: 194px; }
.climate-meter { height: 4px; overflow: hidden; margin: 0 0 14px; border-radius: 5px; background: rgba(255,255,255,.08); }
.climate-meter span { display: block; width: 0; height: 100%; border-radius: inherit; transition: width .35s ease; }
.temperature-card .climate-meter span { background: var(--orange); }
.humidity-card .climate-meter span { background: var(--blue); }
.climate-note, .limitation-card { display: flex; gap: 12px; padding: 17px; }
.climate-note .note-mark, .limitation-card .note-mark { margin-top: 1px; }
.climate-note p, .limitation-card p { margin: 6px 0 0; color: var(--muted); font-size: 11px; line-height: 1.7; }
.climate-updated { display: flex; align-items: center; gap: 8px; padding: 15px 3px; color: var(--faint); font-size: 10px; }
.climate-updated svg { width: 15px; height: 15px; color: var(--lime); }

.history-heading { align-items: center; }
.record-count { color: var(--lime); font: 700 22px 'Segoe UI', Arial, sans-serif; }
.record-count small { color: var(--muted); font: 500 10px 'Segoe UI', Arial, sans-serif; }
.chart-panel, .history-panel { margin-bottom: 16px; padding: 18px; }
.chart-unit { color: var(--orange); font-size: 11px; font-weight: 700; }
.bar-chart { display: flex; min-height: 136px; align-items: flex-end; justify-content: flex-start; gap: clamp(8px, 2vw, 17px); overflow: hidden; margin-top: 17px; padding: 0 6px; border-bottom: 1px solid var(--border); }
.chart-empty { align-self: center; width: 100%; padding: 15px; color: var(--faint); font-size: 10px; text-align: center; }
.bar-column { display: grid; min-width: 25px; max-width: 48px; flex: 1; justify-items: center; gap: 7px; }
.bar-column strong { color: var(--muted); font-size: 8px; font-weight: 500; }
.bar-column span { width: min(100%, 30px); min-height: 6px; border-radius: 7px 7px 2px 2px; background: linear-gradient(180deg, var(--lime), var(--lime-dark)); box-shadow: 0 0 16px rgba(var(--lime-rgb), .14); }
.bar-column small { padding-bottom: 8px; color: var(--faint); font-size: 7px; }
.chart-legend { display: flex; justify-content: space-between; padding-top: 12px; color: var(--faint); font-size: 8px; }
.chart-legend span:first-child { display: inline-flex; align-items: center; gap: 6px; }
.chart-legend i { width: 7px; height: 7px; border-radius: 50%; background: var(--orange); }
.table-refresh { color: var(--faint); font-size: 8px; }
.history-item { display: grid; grid-template-columns: 35px minmax(0, 1fr) auto; align-items: center; gap: 12px; padding: 12px 1px; border-bottom: 1px solid var(--border); }
.history-item:last-child { border-bottom: 0; }
.history-index { display: grid; width: 29px; height: 29px; place-items: center; border-radius: 9px; background: var(--surface-soft); color: var(--lime); font-size: 9px; font-weight: 700; }
.history-reading { display: flex; flex-wrap: wrap; gap: 8px 15px; }
.history-reading strong { font-size: 10px; font-weight: 600; }
.history-reading .temp { color: var(--orange); }
.history-reading .hum { color: var(--blue); }
.history-time { color: var(--faint); font-size: 8px; text-align: right; }
.history-disclaimer { display: flex; align-items: center; gap: 9px; padding: 2px 4px; color: var(--muted); font-size: 9px; line-height: 1.6; }

.settings-card, .instructions-card, .diagnostics-card { margin-bottom: 16px; padding: 20px; }
.theme-card { padding-bottom: 15px; }
.install-description { margin: 14px 0 0; color: var(--muted); font-size: 10px; line-height: 1.65; }
.install-button { margin-top: 14px; }
.install-message { color: var(--faint); line-height: 1.6; }
.theme-setting { display: flex; align-items: center; justify-content: space-between; gap: 16px; margin-top: 18px; padding: 15px; border: 1px solid var(--border); border-radius: 12px; background: var(--surface-raised); }
.theme-setting-copy { display: grid; gap: 5px; }
.theme-setting-copy strong { font-size: 12px; }
.theme-setting-copy small { color: var(--muted); font-size: 10px; line-height: 1.5; }
.theme-switch { display: inline-flex; align-items: center; gap: 9px; flex: 0 0 auto; cursor: pointer; }
.theme-switch input { position: absolute; width: 1px; height: 1px; overflow: hidden; clip: rect(0, 0, 0, 0); white-space: nowrap; clip-path: inset(50%); }
.switch-track { display: inline-flex; width: 42px; height: 24px; align-items: center; padding: 3px; border: 1px solid var(--border); border-radius: 999px; background: var(--surface-soft); transition: background .2s, border-color .2s; }
.switch-track span { width: 16px; height: 16px; border-radius: 50%; background: var(--muted); transition: transform .2s, background .2s; }
.theme-switch input:checked + .switch-track { border-color: var(--lime); background: var(--lime); }
.theme-switch input:checked + .switch-track span { transform: translateX(17px); background: var(--accent-contrast); }
.theme-switch input:focus-visible + .switch-track { outline: 3px solid rgba(var(--lime-rgb), .32); outline-offset: 3px; }
.switch-label { min-width: 22px; color: var(--muted); font-size: 10px; font-weight: 700; }
.diagnostics-updated { color: var(--faint); font-size: 9px; }
.diagnostics-list { display: grid; gap: 0; margin: 15px 0 0; }
.diagnostics-list > div { display: flex; align-items: center; justify-content: space-between; gap: 14px; padding: 10px 0; border-bottom: 1px solid var(--border); }
.diagnostics-list > div:last-child { border-bottom: 0; }
.diagnostics-list > [hidden] { display: none; }
.diagnostics-list dt { color: var(--muted); font-size: 10px; }
.diagnostics-list dd { margin: 0; color: var(--faint); font-size: 10px; text-align: right; overflow-wrap: anywhere; }
.diagnostics-list dd[data-level="online"] { color: var(--ok); }
.diagnostics-list dd[data-level="error"] { color: var(--danger); }
.diagnostics-list dd[data-level="checking"] { color: var(--warning); }
.diagnostic-error-row dd { max-width: 62%; color: var(--danger); }
.diagnostics-help { margin: 12px 0 0; color: var(--faint); font-size: 9px; line-height: 1.65; }
.settings-icon { background: rgba(var(--lime-rgb), .12); color: var(--lime); }
.settings-icon svg { width: 16px; height: 16px; }
.settings-card form { margin-top: 23px; }
.field-label { display: block; margin-bottom: 8px; color: var(--muted); font-size: 10px; font-weight: 600; }
.input-wrap { display: flex; align-items: center; gap: 9px; padding: 5px; border: 1px solid var(--border); border-radius: 11px; background: rgba(0,0,0,.12); }
.input-prefix { display: grid; width: 35px; height: 35px; flex: 0 0 auto; place-items: center; color: var(--blue); }
.input-prefix svg { width: 17px; height: 17px; }
.input-wrap input { width: 100%; min-width: 0; height: 38px; border: 0; outline: 0; background: transparent; color: var(--text); font-size: 12px; }
.input-wrap input::placeholder { color: var(--faint); }
.input-wrap:focus-within { border-color: rgba(var(--lime-rgb), .55); box-shadow: 0 0 0 3px rgba(var(--lime-rgb), .12); }
.save-button { display: inline-flex; align-items: center; justify-content: center; gap: 7px; min-height: 37px; flex: 0 0 auto; padding: 0 12px; border: 0; border-radius: 8px; background: var(--lime); color: var(--accent-contrast); font-size: 9px; font-weight: 700; cursor: pointer; }
.save-button:hover { filter: brightness(1.08); }
.save-button:disabled { opacity: .6; cursor: wait; }
.save-button svg { width: 13px; height: 13px; }
.field-help { margin: 9px 0 0; color: var(--faint); font-size: 9px; }
code { color: var(--lime); font-family: ui-monospace, SFMono-Regular, Consolas, monospace; font-size: .95em; }
.form-message { min-height: 0; margin: 0; font-size: 10px; }
.form-message:not(:empty) { margin-top: 10px; }
.form-message.success { color: var(--ok); }
.form-message.error { color: var(--danger); }
.setup-steps { display: grid; gap: 0; margin: 15px 0 0; padding: 0; list-style: none; }
.setup-steps li { display: grid; grid-template-columns: 31px 1fr; gap: 11px; padding: 13px 0; border-bottom: 1px solid var(--border); }
.setup-steps li:last-child { padding-bottom: 0; border-bottom: 0; }
.setup-steps li > span { color: var(--lime); font: 700 10px 'Segoe UI', Arial, sans-serif; }
.setup-steps strong { font-size: 10px; }
.setup-steps p { margin: 4px 0 0; color: var(--muted); font-size: 9px; line-height: 1.65; }
.limitation-card { margin-bottom: 20px; }

.mobile-nav { display: none; }

@media (min-width: 1450px) {
  .main-content { padding-right: 64px; padding-left: 64px; }
  .metric-card { min-height: 205px; padding: 23px; }
  .overview-grid { margin-top: 21px; }
}

@media (max-width: 1080px) {
  .sidebar { width: 214px; }
  .main-content { margin-left: 214px; padding-right: 29px; padding-left: 29px; }
  .overview-grid { grid-template-columns: 1fr; }
  .sensor-panel, .recent-panel { min-height: auto; }
}

@media (max-width: 700px) {
  body { min-height: 100dvh; }
  .sidebar { display: none; }
  .main-content { min-height: 100dvh; margin: 0; padding: 0 16px calc(81px + env(safe-area-inset-bottom)); }
  .topbar { min-height: 76px; gap: 10px; }
  .mobile-brand { display: inline-flex; gap: 8px; }
  .mobile-brand .brand-mark { width: 31px; height: 31px; border-radius: 10px; padding: 6px; }
  .mobile-brand .brand-copy strong { font-size: 17px; }
  .mobile-brand .brand-copy small { font-size: 7px; letter-spacing: 1.25px; }
  .page-heading { flex: 1; min-width: 0; }
  .page-heading .eyebrow { margin-bottom: 4px; font-size: 7px; }
  h1 { font-size: 14px; letter-spacing: -.25px; }
  .wave { font-size: 12px; }
  .topbar-actions { gap: 8px; }
  .last-updated { display: none; }
  .icon-button { width: 35px; height: 35px; border-radius: 11px; }
  .connection-banner { gap: 10px; margin-top: 14px; padding: 11px; }
  .banner-icon { width: 31px; height: 31px; }
  .banner-copy strong { font-size: 10px; }
  .banner-copy small { max-width: 205px; font-size: 9px; }
  .banner-state { font-size: 7px; letter-spacing: .6px; }
  .page-panel { padding-top: 24px; }
  .section-intro { align-items: flex-start; margin-bottom: 15px; }
  .section-intro .eyebrow { margin-bottom: 6px; font-size: 8px; }
  h2 { font-size: 19px; }
  .section-description { font-size: 11px; }
  .update-chip { margin-top: 2px; padding: 6px 7px; font-size: 7px; letter-spacing: .45px; }
  .metric-grid { gap: 10px; }
  .metric-card { min-height: 157px; padding: 13px 12px 12px; border-radius: 14px; }
  .metric-topline { gap: 7px; }
  .metric-icon { width: 28px; height: 28px; border-radius: 9px; }
  .metric-icon svg { width: 15px; height: 15px; }
  .metric-category { font-size: 7px; letter-spacing: .55px; }
  .metric-live { padding: 4px 5px; font-size: 6px; }
  .metric-value { gap: 5px; margin: 21px 0 12px; font-size: clamp(32px, 10vw, 43px); letter-spacing: -2px; }
  .metric-unit { font-size: 13px; }
  .metric-footer { align-items: flex-start; flex-direction: column; gap: 4px; }
  .metric-caption, .metric-indicator { font-size: 8px; text-align: left; }
  .metric-decoration { right: -51px; bottom: -75px; opacity: .1; }
  .overview-grid { gap: 11px; margin-top: 12px; }
  .sensor-panel, .recent-panel { padding: 15px; border-radius: 14px; }
  .panel-heading .eyebrow { margin-bottom: 5px; font-size: 7px; }
  h3 { font-size: 13px; }
  .panel-note { font-size: 8px; }
  .recent-list { margin-top: 10px; }
  .recent-item { gap: 8px; padding: 9px 0; }
  .recent-values { gap: 9px; }
  .recent-values strong { font-size: 9px; }
  .recent-time { font-size: 7px; }
  .page-footer { padding-top: 19px; font-size: 8px; }
  .climate-metrics { gap: 10px; }
  .climate-metrics .metric-card { min-height: 168px; }
  .climate-note, .limitation-card { padding: 14px; }
  .climate-note p, .limitation-card p { font-size: 10px; }
  .record-count { font-size: 19px; }
  .chart-panel, .history-panel { margin-bottom: 12px; padding: 14px; }
  .bar-chart { min-height: 126px; }
  .history-item { grid-template-columns: 29px minmax(0,1fr) auto; gap: 8px; padding: 11px 0; }
  .history-reading { gap: 6px 10px; }
  .history-reading strong { font-size: 9px; }
  .history-time { max-width: 105px; font-size: 7px; }
  .history-disclaimer { align-items: flex-start; font-size: 8px; }
  .settings-card, .instructions-card, .diagnostics-card { padding: 15px; }
  .theme-setting { padding: 12px; }
  .input-wrap { flex-wrap: wrap; gap: 4px; padding: 5px; }
  .input-prefix { width: 29px; }
  .input-wrap input { width: calc(100% - 37px); height: 36px; font-size: 11px; }
  .save-button { width: 100%; min-height: 38px; margin-top: 4px; }
  .field-help { line-height: 1.6; }
  .setup-steps p { font-size: 9px; }
  .diagnostics-list dt, .diagnostics-list dd { font-size: 9px; }
  .diagnostics-updated { font-size: 8px; }
  .mobile-nav { position: fixed; z-index: 10; inset: auto 0 0; display: grid; grid-template-columns: repeat(4, 1fr); padding: 7px 9px calc(7px + env(safe-area-inset-bottom)); border-top: 1px solid var(--border); background: var(--sidebar); backdrop-filter: blur(18px); }
  .mobile-nav-link { display: grid; min-height: 51px; align-content: center; justify-items: center; gap: 4px; border: 0; border-radius: 10px; background: transparent; color: var(--faint); cursor: pointer; }
  .mobile-nav-link svg { width: 19px; height: 19px; }
  .mobile-nav-link span { font-size: 8px; font-weight: 600; }
  .mobile-nav-link.active { color: var(--lime); }
}

@media (max-width: 375px) {
  .main-content { padding-right: 12px; padding-left: 12px; }
  .mobile-brand { gap: 6px; }
  .mobile-brand .brand-copy strong { font-size: 15px; }
  h1 { font-size: 12px; }
  .banner-copy small { max-width: 160px; }
  .banner-state { font-size: 6px; }
  .metric-card { padding-right: 9px; padding-left: 9px; }
  .metric-category { font-size: 6px; letter-spacing: .3px; }
}

@media (prefers-reduced-motion: reduce) {
  *, *::before, *::after { scroll-behavior: auto !important; animation-duration: .01ms !important; animation-iteration-count: 1 !important; transition-duration: .01ms !important; }
}
)PMCSS";

static const char DASHBOARD_CLOUD_CONFIG[] PROGMEM = R"PMCONFIG(window.POULTRY_FIREBASE_CONFIG = {
  apiKey: 'AIzaSyDovLKo3djdRbs963vqKdbj-geRWyzMTrg',
  databaseURL: 'https://poultry-house-monitor-default-rtdb.asia-southeast1.firebasedatabase.app',
};
)PMCONFIG";

static const char DASHBOARD_JS[] PROGMEM = R"PMJS((() => {
  'use strict';

  const DEFAULT_DEVICE_URL = 'http://192.168.4.1';
  const FIREBASE_CONFIG = window.POULTRY_FIREBASE_CONFIG &&
      typeof window.POULTRY_FIREBASE_CONFIG === 'object'
    ? window.POULTRY_FIREBASE_CONFIG
    : null;
  const FIREBASE_DATABASE_URL = typeof FIREBASE_CONFIG?.databaseURL === 'string'
    ? FIREBASE_CONFIG.databaseURL.trim().replace(/\/+$/, '')
    : '';
  const IS_FIREBASE_CLOUD_PAGE =
    window.location.protocol === 'https:' && Boolean(FIREBASE_DATABASE_URL);
  const STORAGE_KEY = 'poultry-monitor-device-url';
  const THEME_STORAGE_KEY = 'poultry-monitor-theme';
  const REFRESH_INTERVAL_MS = 3000;
  const REQUEST_TIMEOUT_MS = 5000;
  const DATA_STALE_MS = 10000;
  const WAITING_FOR_READING_MESSAGE = 'Waiting for the first ESP32 reading.';
  const MAX_CHART_RECORDS = 12;
  const BLE_SERVICE_UUID = 'a3c87500-8ed3-4bdf-8a39-a01bebede295';
  const BLE_STATUS_CHARACTERISTIC_UUID = 'a3c87501-8ed3-4bdf-8a39-a01bebede295';
  const BLE_HISTORY_CHARACTERISTIC_UUID = 'a3c87502-8ed3-4bdf-8a39-a01bebede295';

  const $ = (selector) => document.querySelector(selector);
  const $$ = (selector) => Array.from(document.querySelectorAll(selector));
  const elements = {
    banner: $('#connection-banner'),
    connectionTitle: $('#connection-title'),
    connectionMessage: $('#connection-message'),
    connectionState: $('#connection-state'),
    stopWarningButton: $('#stop-warning-button'),
    warningActionMessage: $('#warning-action-message'),
    diagnosticAttempt: $('#diagnostic-attempt'),
    diagnosticStatusApi: $('#diagnostic-status-api'),
    diagnosticHistoryApi: $('#diagnostic-history-api'),
    diagnosticLastReading: $('#diagnostic-last-reading'),
    diagnosticErrorRow: $('#diagnostic-error-row'),
    diagnosticError: $('#diagnostic-error'),
    sidebarStatus: $('#sidebar-status'),
    sidebarAddress: $('#sidebar-address'),
    deviceAddressLabel: $('#device-address-label'),
    updatedLabel: $('#updated-label'),
    climateUpdatedLabel: $('#climate-updated-label'),
    temperatureValue: $('#temperature-value'),
    humidityValue: $('#humidity-value'),
    climateTemperatureValue: $('#climate-temperature-value'),
    climateHumidityValue: $('#climate-humidity-value'),
    temperatureCondition: $('#temperature-condition'),
    humidityCondition: $('#humidity-condition'),
    climateTemperatureCondition: $('#climate-temperature-condition'),
    climateHumidityCondition: $('#climate-humidity-condition'),
    temperatureMeter: $('#temperature-meter'),
    humidityMeter: $('#humidity-meter'),
    sensorHealthIcon: $('#sensor-health-icon'),
    sensorHealthPill: $('#sensor-health-pill'),
    deviceHealthPill: $('#device-health-pill'),
    recentList: $('#recent-list'),
    historyList: $('#history-list'),
    historyChart: $('#history-chart'),
    recordCount: $('#record-count'),
    deviceUrlInput: $('#device-url'),
    settingsForm: $('#settings-form'),
    settingsMessage: $('#settings-message'),
    darkModeToggle: $('#dark-mode-toggle'),
    themeModeLabel: $('#theme-mode-label'),
    themeMessage: $('#theme-message'),
    installButton: $('#install-button'),
    installMessage: $('#install-message'),
    saveButton: $('#save-button'),
    refreshButton: $('#refresh-button'),
    bluetoothConnectButton: $('#bluetooth-connect-button'),
    pageTitle: $('#page-title'),
    headingSection: $('#heading-section'),
    statusDots: $$('.status-dot'),
  };

  const pageInfo = {
    home: { title: 'Good day, caretaker <span class="wave">✳</span>', section: 'OVERVIEW' },
    climate: { title: 'House climate', section: 'CLIMATE' },
    history: { title: 'Sensor history', section: 'HISTORY' },
    settings: { title: 'Monitor settings', section: 'PREFERENCES' },
  };

  const state = {
    deviceUrl: getSavedDeviceUrl(),
    connected: false,
    sensorOK: false,
    warning: '',
    activeWarningKey: '',
    warningSilenced: false,
    stoppingWarning: false,
    warningActionMessage: '',
    temperature: null,
    humidity: null,
    history: [],
    bluetoothHistory: [],
    lastUpdated: null,
    lastAttemptAt: null,
    statusApiState: 'waiting',
    historyApiState: 'waiting',
    lastError: '',
    refreshing: false,
    refreshQueued: false,
    timer: null,
    bluetoothDevice: null,
    bluetoothCharacteristic: null,
    bluetoothHistoryCharacteristic: null,
    connectionType: 'network',
    firebaseStatusSource: null,
    firebaseHistorySource: null,
    firebaseListenersStarted: false,
    firebaseCurrentStatus: null,
    firebaseHistoryRecords: new Map(),
    bluetoothReadyForReconnect: false,
  };

  let deferredInstallPrompt = null;

  function getSavedDeviceUrl() {
    try {
      const saved = localStorage.getItem(STORAGE_KEY);
      return saved && isValidDeviceUrl(saved) ? normalizeUrl(saved) : getDefaultDeviceUrl();
    } catch (error) {
      console.warn('Could not read the saved device address:', error);
      return getDefaultDeviceUrl();
    }
  }

  function getSavedTheme() {
    try {
      return localStorage.getItem(THEME_STORAGE_KEY) === 'light' ? 'light' : 'dark';
    } catch (error) {
      console.warn('Could not read the saved display theme:', error);
      return 'dark';
    }
  }

  function applyTheme(theme) {
    document.documentElement.dataset.theme = theme;
    elements.darkModeToggle.checked = theme === 'dark';
    elements.themeModeLabel.textContent = theme === 'dark' ? 'On' : 'Off';
    document.querySelector('meta[name="theme-color"]').content =
      theme === 'dark' ? '#10191b' : '#f0f7f5';
  }

  function isAppInstalled() {
    return window.matchMedia('(display-mode: standalone)').matches ||
      navigator.standalone === true;
  }

  function showInstallMessage(message) {
    elements.installMessage.textContent = message;
  }

  async function installApp() {
    if (isAppInstalled()) {
      showInstallMessage('Coop Care is already installed on this device.');
      return;
    }

    if (!deferredInstallPrompt) {
      const isAppleMobile = /iphone|ipad|ipod/i.test(navigator.userAgent);
      showInstallMessage(isAppleMobile
        ? 'To install on iPhone or iPad, tap Share in Safari, then choose Add to Home Screen.'
        : 'Open your browser menu and choose Install app or Add to Home Screen. Install is available over HTTPS or localhost.');
      return;
    }

    const installPrompt = deferredInstallPrompt;
    deferredInstallPrompt = null;
    try {
      await installPrompt.prompt();
      const choice = await installPrompt.userChoice;
      showInstallMessage(choice.outcome === 'accepted'
        ? 'Installing Coop Care…'
        : 'Installation was cancelled. You can install it later from your browser menu.');
    } catch (error) {
      console.error('Could not start app installation:', error);
      showInstallMessage('Could not start installation. Use your browser menu to install the app.');
    }
  }

  function setupProgressiveWebApp() {
    window.addEventListener('beforeinstallprompt', (event) => {
      event.preventDefault();
      deferredInstallPrompt = event;
    });
    window.addEventListener('appinstalled', () => {
      deferredInstallPrompt = null;
      showInstallMessage('Coop Care was installed successfully.');
    });

    if ('serviceWorker' in navigator && window.isSecureContext) {
      navigator.serviceWorker.register('./service-worker.js')
        .catch((error) => console.error('Could not register the offline app shell:', error));
    }
  }

  function saveThemePreference() {
    const previousTheme = document.documentElement.dataset.theme || 'dark';
    const selectedTheme = elements.darkModeToggle.checked ? 'dark' : 'light';
    applyTheme(selectedTheme);
    elements.themeMessage.textContent = '';
    elements.themeMessage.className = 'form-message';

    try {
      localStorage.setItem(THEME_STORAGE_KEY, selectedTheme);
    } catch (error) {
      console.error('Could not save the display theme:', error);
      applyTheme(previousTheme);
      elements.themeMessage.textContent = 'Could not save this preference in your browser.';
      elements.themeMessage.className = 'form-message error';
    }
  }

  function getDefaultDeviceUrl() {
    if (window.location.hostname === '192.168.4.1') {
      return window.location.origin;
    }
    return DEFAULT_DEVICE_URL;
  }

  function isValidDeviceUrl(value) {
    try {
      const url = new URL(value.trim());
      return (url.protocol === 'http:' || url.protocol === 'https:') &&
        url.hostname !== '' &&
        url.username === '' &&
        url.password === '' &&
        url.search === '' &&
        url.hash === '' &&
        (url.pathname === '/' || url.pathname === '');
    } catch (_) {
      return false;
    }
  }

  function normalizeUrl(value) {
    return value.trim().replace(/\/+$/, '');
  }

  function showMessage(message, type) {
    elements.settingsMessage.textContent = message;
    elements.settingsMessage.className = `form-message ${type}`;
  }

  function setPage(page) {
    if (!pageInfo[page]) return;

    $$('.page-panel').forEach((panel) => {
      const active = panel.dataset.pagePanel === page;
      panel.hidden = !active;
      panel.classList.toggle('active', active);
    });

    $$('[data-page]').forEach((button) => {
      const active = button.dataset.page === page;
      button.classList.toggle('active', active);
      if (active) button.setAttribute('aria-current', 'page');
      else button.removeAttribute('aria-current');
    });

    elements.pageTitle.innerHTML = pageInfo[page].title;
    elements.headingSection.textContent = pageInfo[page].section;
    if (window.location.hash !== `#${page}`) {
      history.replaceState(null, '', `#${page}`);
    }
  }

  function formatNumber(value) {
    return Number.isFinite(value) ? value.toFixed(1) : '--.-';
  }

  function formatUptime(milliseconds) {
    if (!Number.isFinite(milliseconds) || milliseconds < 0) {
      return 'Device uptime unavailable';
    }

    const seconds = Math.floor(milliseconds / 1000);
    const days = Math.floor(seconds / 86400);
    const hours = Math.floor((seconds % 86400) / 3600);
    const minutes = Math.floor((seconds % 3600) / 60);
    const remainder = seconds % 60;
    const time = [hours, minutes, remainder].map((part) => String(part).padStart(2, '0')).join(':');
    return days > 0 ? `Uptime ${days}d ${time}` : `Uptime ${time}`;
  }

  function formatHistoryTimestamp(record) {
    if (record.recordedAt) {
      return `Recorded ${new Intl.DateTimeFormat(undefined, {
        month: 'short',
        day: 'numeric',
        hour: '2-digit',
        minute: '2-digit',
        second: '2-digit',
      }).format(new Date(record.recordedAt))}`;
    }
    return formatUptime(record.elapsedMs);
  }

  function formatUpdatedAt(date) {
    if (!(date instanceof Date)) return 'Waiting for readings';
    const formatted = new Intl.DateTimeFormat(undefined, {
      hour: '2-digit',
      minute: '2-digit',
      second: '2-digit',
    }).format(date);
    return Date.now() - date.getTime() > DATA_STALE_MS
      ? `Stale · last received ${formatted}`
      : `Updated ${formatted}`;
  }

  function renderDiagnostics() {
    const setApiState = (element, value) => {
      element.textContent = value === 'online' ? 'Reachable' :
        value === 'error' ? 'Error' :
          value === 'checking' ? 'Checking…' :
            value === 'not-available' ? 'Not available in Bluetooth mode' :
            value === 'not-checked' ? 'Not checked' : 'Waiting';
      element.dataset.level = value;
    };

    setApiState(elements.diagnosticStatusApi, state.statusApiState);
    setApiState(elements.diagnosticHistoryApi, state.historyApiState);
    elements.diagnosticAttempt.textContent = state.lastAttemptAt
      ? `Attempted ${new Intl.DateTimeFormat(undefined, {
        hour: '2-digit',
        minute: '2-digit',
        second: '2-digit',
      }).format(state.lastAttemptAt)}`
      : 'Not checked yet';
    elements.diagnosticLastReading.textContent = state.lastUpdated
      ? formatUpdatedAt(state.lastUpdated)
      : 'No reading received yet';
    elements.diagnosticErrorRow.hidden = !state.lastError;
    elements.diagnosticError.textContent = state.lastError;
  }

  function getApiRequestUrl(path, baseUrl) {
    if (IS_FIREBASE_CLOUD_PAGE) {
      if (path === '/api/status') {
        return `${FIREBASE_DATABASE_URL}/sensor/latest.json`;
      }
      if (path === '/api/history') {
        const query = new URLSearchParams({
          orderBy: '"recordedAt"',
          limitToLast: '500',
        });
        return `${FIREBASE_DATABASE_URL}/sensor/history.json?${query}`;
      }
      throw new Error('This action is not available from the public cloud dashboard.');
    }

    const isEsp32Dashboard =
      window.location.protocol === 'http:' &&
      window.location.hostname === '192.168.4.1' &&
      normalizeUrl(baseUrl) === normalizeUrl(window.location.origin);
    const isLocalNodeDashboard =
      window.location.protocol === 'http:' &&
      window.location.hostname !== '192.168.4.1';
    return isEsp32Dashboard || isLocalNodeDashboard
      ? path
      : `${baseUrl}${path}`;
  }

  function getHttpsHttpMismatchMessage(baseUrl) {
    if (window.location.protocol === 'https:' && !FIREBASE_DATABASE_URL) {
      return 'Public live readings are not configured yet. Add the Firebase Realtime Database URL to cloud-config.js and connect the ESP32 to internet-capable Wi-Fi.';
    }
    if (window.location.protocol === 'https:' && FIREBASE_DATABASE_URL) {
      try {
        const cloudUrl = new URL(FIREBASE_DATABASE_URL);
        if (cloudUrl.protocol !== 'https:' || cloudUrl.username || cloudUrl.password ||
            cloudUrl.search || cloudUrl.hash) {
          return 'The Firebase Realtime Database URL must be a valid HTTPS URL.';
        }
        return '';
      } catch (_) {
        return 'The Firebase Realtime Database URL in cloud-config.js is invalid.';
      }
    }
    try {
      if (window.location.protocol === 'https:' && new URL(baseUrl).protocol === 'http:') {
        return 'GitHub Pages is served over HTTPS, so browsers block direct requests to the ESP32 local HTTP address. Live readings need a public HTTPS API and ESP32 firmware that sends data to it.';
      }
    } catch (_) {
      return '';
    }
    return '';
  }

  function setCondition(element, label, level) {
    element.textContent = label;
    element.dataset.level = level;
  }

  function renderStatus() {
    const banner = elements.banner;
    const warning = state.warning || (!state.sensorOK
      ? 'The ESP32 reports that the sensor needs attention.'
      : '');
    const isHealthy = state.connected && state.sensorOK && !warning;
    const isWarning = state.connected && Boolean(warning);

    banner.classList.toggle('is-connected', isHealthy);
    banner.classList.toggle('is-warning', isWarning);
    banner.classList.toggle('is-error', !state.connected);

    elements.statusDots.forEach((dot) => {
      dot.classList.remove('connected', 'warning', 'error');
      if (!state.connected) {
        dot.classList.add('error');
      } else if (isWarning) {
        dot.classList.add('warning');
      } else {
        dot.classList.add('connected');
      }
    });

    elements.bluetoothConnectButton.textContent = state.connectionType === 'bluetooth' &&
      state.bluetoothDevice?.gatt?.connected
      ? 'Disconnect Bluetooth'
      : 'Connect ESP32 via Bluetooth';
    elements.bluetoothConnectButton.disabled = !navigator.bluetooth;
    elements.bluetoothConnectButton.title = navigator.bluetooth
      ? 'Connect directly to the ESP32 without Wi-Fi'
      : 'Bluetooth connection requires Android Chrome over HTTPS';
    elements.stopWarningButton.hidden = !state.connected || !warning ||
      state.connectionType === 'bluetooth' ||
      IS_FIREBASE_CLOUD_PAGE;
    elements.stopWarningButton.disabled = state.stoppingWarning || state.warningSilenced;
    elements.stopWarningButton.textContent = state.stoppingWarning
      ? 'Stopping…'
      : state.warningSilenced ? 'Alarm silenced' : 'Stop hardware alarm';
    elements.warningActionMessage.textContent = state.warningActionMessage;

    if (!state.connected) {
      elements.connectionTitle.textContent = 'Monitor is offline';
      elements.connectionMessage.textContent = state.bluetoothReadyForReconnect
        ? 'Bluetooth disconnected. The ESP32 is ready; tap Connect ESP32 via Bluetooth to connect again or choose another device.'
        : 'Tap “Connect ESP32 via Bluetooth” to connect directly without Wi-Fi.';
      elements.connectionState.textContent = 'OFFLINE';
      elements.sidebarStatus.textContent = 'Disconnected';
      elements.deviceHealthPill.textContent = 'OFFLINE';
      elements.deviceHealthPill.className = 'health-pill offline';
      elements.sensorHealthPill.textContent = 'NO DATA';
      elements.sensorHealthPill.className = 'health-pill offline';
      elements.sensorHealthIcon.style.background = 'rgba(var(--danger-rgb), .1)';
      elements.sensorHealthIcon.style.color = 'var(--danger)';
      return;
    }

    elements.sidebarStatus.textContent = warning ? 'Hardware warning' : 'Monitor online';
    elements.deviceHealthPill.textContent = state.sensorOK ? 'ONLINE' : 'CHECK SENSOR';
    elements.deviceHealthPill.className = `health-pill ${state.sensorOK ? 'online' : 'offline'}`;

    if (warning) {
      elements.connectionTitle.textContent = 'Hardware warning';
      elements.connectionMessage.textContent = warning;
      elements.connectionState.textContent = 'WARNING';
      elements.sensorHealthPill.textContent = state.sensorOK ? 'WARNING' : 'CHECK SENSOR';
      elements.sensorHealthPill.className = `health-pill ${state.sensorOK ? 'warning' : 'offline'}`;
      elements.sensorHealthIcon.style.background = 'rgba(var(--warning-rgb), .1)';
      elements.sensorHealthIcon.style.color = 'var(--warning)';
    } else {
      elements.connectionTitle.textContent = state.connectionType === 'bluetooth'
        ? 'Connected to ESP32 via Bluetooth'
        : state.connectionType === 'cloud' ? 'Connected to cloud monitor'
          : 'Your monitor is connected';
      elements.connectionMessage.textContent = state.connectionType === 'bluetooth'
        ? 'Live DHT22 readings and saved history are refreshing from the monitor over Bluetooth. Cloud history continues syncing when the monitor has internet.'
        : state.connectionType === 'cloud'
          ? 'Live readings are streaming from Firebase Realtime Database.'
          : 'The ESP32-S3 is reporting data from the DHT22 sensor.';
      elements.connectionState.textContent = state.connectionType === 'bluetooth'
        ? 'BLUETOOTH'
        : state.connectionType === 'cloud' ? 'CLOUD LIVE'
          : 'ALL SYSTEMS GO';
      elements.sensorHealthPill.textContent = 'HEALTHY';
      elements.sensorHealthPill.className = 'health-pill online';
      elements.sensorHealthIcon.style.background = 'rgba(var(--ok-rgb), .12)';
      elements.sensorHealthIcon.style.color = 'var(--ok)';
    }
  }

  function renderReadings() {
    const temperature = state.temperature;
    const humidity = state.humidity;
    const temperatureLabel = temperature === null ? 'Waiting for data' : `${formatNumber(temperature)} °C`;
    const humidityLabel = humidity === null ? 'Waiting for data' : `${formatNumber(humidity)} %RH`;

    elements.temperatureValue.textContent = formatNumber(temperature);
    elements.humidityValue.textContent = formatNumber(humidity);
    elements.climateTemperatureValue.textContent = formatNumber(temperature);
    elements.climateHumidityValue.textContent = formatNumber(humidity);
    setCondition(elements.temperatureCondition, temperatureLabel, temperature === null ? '' : 'normal');
    setCondition(elements.climateTemperatureCondition, temperatureLabel, temperature === null ? '' : 'normal');
    setCondition(elements.humidityCondition, humidityLabel, humidity === null ? '' : 'normal');
    setCondition(elements.climateHumidityCondition, humidityLabel, humidity === null ? '' : 'normal');
    elements.temperatureMeter.style.width = `${temperature === null ? 0 : Math.max(0, Math.min(100, temperature * 2))}%`;
    elements.humidityMeter.style.width = `${humidity === null ? 0 : Math.max(0, Math.min(100, humidity))}%`;
    elements.updatedLabel.textContent = formatUpdatedAt(state.lastUpdated);
    elements.updatedLabel.parentElement.classList.toggle(
      'is-stale',
      state.lastUpdated instanceof Date && Date.now() - state.lastUpdated.getTime() > DATA_STALE_MS,
    );
    elements.climateUpdatedLabel.textContent = state.lastUpdated
      ? `Latest app reading: ${formatUpdatedAt(state.lastUpdated)}. Values are received from the ESP32.`
      : 'Waiting for the first successful reading';
    renderDiagnostics();
  }

  function makeHistoryEntry(record, index, compact) {
    const container = document.createElement('div');
    container.className = compact ? 'recent-item' : 'history-item';

    const number = document.createElement('span');
    number.className = compact ? 'recent-number' : 'history-index';
    number.textContent = String(index + 1);
    container.append(number);

    const values = document.createElement('div');
    values.className = compact ? 'recent-values' : 'history-reading';
    const temperature = document.createElement('strong');
    temperature.className = 'temp';
    temperature.textContent = `${record.temperature.toFixed(1)} °C`;
    const humidity = document.createElement('strong');
    humidity.className = 'hum';
    humidity.textContent = `${record.humidity.toFixed(1)} %RH`;
    values.append(temperature, humidity);
    container.append(values);

    const time = document.createElement('span');
    time.className = compact ? 'recent-time' : 'history-time';
    time.textContent = formatHistoryTimestamp(record);
    container.append(time);
    return container;
  }

  function validateHistoryRecord(record) {
    if (!record || typeof record !== 'object' ||
        typeof record.temperature !== 'number' || !Number.isFinite(record.temperature) ||
        typeof record.humidity !== 'number' || !Number.isFinite(record.humidity)) {
      throw new Error('The sensor API returned an invalid history record.');
    }
    const recordedAt = typeof record.recordedAt === 'number' ||
          typeof record.recordedAt === 'string'
      ? new Date(record.recordedAt)
      : null;
    return {
      temperature: record.temperature,
      humidity: record.humidity,
      elapsedMs: typeof record.elapsedMs === 'number' && Number.isFinite(record.elapsedMs)
          ? record.elapsedMs
          : null,
      deviceSequence: Number.isSafeInteger(record.deviceSequence) && record.deviceSequence >= 0
        ? record.deviceSequence
        : null,
      recordedAt: recordedAt && Number.isFinite(recordedAt.getTime())
          ? recordedAt.toISOString()
          : null,
    };
  }

  function renderHistory() {
    elements.recentList.replaceChildren();
    elements.historyList.replaceChildren();

    if (state.history.length === 0) {
      const emptyHistoryMessage = state.connectionType === 'bluetooth'
        ? 'Waiting for saved ESP32 history.'
        : state.connectionType === 'cloud'
          ? 'Waiting for the first Firebase cloud reading.'
          : 'No readings have been saved to the local SQL database yet.';
      elements.recentList.innerHTML = `<div class="empty-state">${emptyHistoryMessage}</div>`;
      elements.historyList.innerHTML = `<div class="empty-state">${emptyHistoryMessage}</div>`;
      elements.historyChart.innerHTML = `<div class="chart-empty">${emptyHistoryMessage}</div>`;
      elements.recordCount.innerHTML = '0 <small>records</small>';
      return;
    }

    state.history.slice(0, 3).forEach((record, index) => {
      elements.recentList.append(makeHistoryEntry(record, index, true));
    });
    state.history.forEach((record, index) => {
      elements.historyList.append(makeHistoryEntry(record, index, false));
    });
    elements.recordCount.innerHTML = `${state.history.length} <small>${state.history.length === 1 ? 'record' : 'records'}</small>`;
    renderHistoryChart();
  }

  function renderHistoryChart() {
    const records = state.history.slice(0, MAX_CHART_RECORDS).reverse();
    elements.historyChart.replaceChildren();
    if (records.length === 0) return;

    const values = records.map((record) => record.temperature);
    const minimum = Math.min(...values);
    const maximum = Math.max(...values);
    const range = Math.max(maximum - minimum, 1);

    records.forEach((record, index) => {
      const column = document.createElement('div');
      column.className = 'bar-column';
      const value = document.createElement('strong');
      value.textContent = record.temperature.toFixed(1);
      const bar = document.createElement('span');
      const height = 28 + ((record.temperature - minimum) / range) * 55;
      bar.style.height = `${height}%`;
      bar.setAttribute('aria-label', `${record.temperature.toFixed(1)} degrees Celsius`);
      const label = document.createElement('small');
      label.textContent = `#${index + 1}`;
      column.append(value, bar, label);
      elements.historyChart.append(column);
    });
  }

  async function requestJson(path, baseUrl) {
    const controller = new AbortController();
    const timeout = window.setTimeout(() => controller.abort(), REQUEST_TIMEOUT_MS);
    try {
      const response = await fetch(getApiRequestUrl(path, baseUrl), {
        method: 'GET',
        cache: 'no-store',
        headers: { Accept: 'application/json' },
        signal: controller.signal,
      });

      if (!response.ok) {
        const detail = (await response.text()).trim().slice(0, 180);
        throw new Error(`HTTP ${response.status} for ${path}.${detail ? ` ${detail}` : ''}`);
      }

      let data;
      try {
        data = await response.json();
      } catch (_) {
        throw new Error(`The monitor returned invalid JSON for ${path}.`);
      }

      if (IS_FIREBASE_CLOUD_PAGE && path === '/api/status' && data === null) {
        return {
          temperature: null,
          humidity: null,
          sensorOK: false,
          warning: WAITING_FOR_READING_MESSAGE,
          recordedAt: null,
        };
      }
      if (IS_FIREBASE_CLOUD_PAGE && path === '/api/history') {
        if (data === null) return { history: [] };
        if (!data || typeof data !== 'object') {
          throw new Error('Firebase returned an invalid sensor history response.');
        }
        const history = Object.entries(data).map(([key, record]) => ({
          ...validateHistoryRecord(record),
          firebaseKey: key,
        }));
        history.sort((left, right) => {
          const leftTime = left.recordedAt ? Date.parse(left.recordedAt) : 0;
          const rightTime = right.recordedAt ? Date.parse(right.recordedAt) : 0;
          return rightTime - leftTime;
        });
        return { history };
      }
      return data;
    } finally {
      window.clearTimeout(timeout);
    }
  }

  function applyFirebaseStatus(status) {
    if (!state.bluetoothCharacteristic) state.connectionType = 'cloud';
    if (status === null) {
      state.connected = true;
      state.sensorOK = false;
      state.temperature = null;
      state.humidity = null;
      state.warning = WAITING_FOR_READING_MESSAGE;
      state.activeWarningKey = state.warning;
      state.warningSilenced = false;
      state.lastUpdated = null;
      state.statusApiState = 'online';
      renderStatus();
      renderReadings();
      renderDiagnostics();
      return;
    }

    applySensorStatus(status);
    state.statusApiState = 'online';
    state.lastError = '';
    renderDiagnostics();
  }

  function handleFirebaseStatusEvent(event) {
    const update = JSON.parse(event.data);
    if (!update || typeof update.path !== 'string') {
      throw new Error('Firebase sent an invalid live status event.');
    }

    const segments = update.path.split('/').filter(Boolean);
    if (segments.length === 0) {
      if (event.type === 'patch' && update.data && typeof update.data === 'object') {
        state.firebaseCurrentStatus = {
          ...(state.firebaseCurrentStatus || {}),
          ...update.data,
        };
      } else {
        state.firebaseCurrentStatus = update.data;
      }
    } else {
      const current = state.firebaseCurrentStatus || {};
      if (segments.length === 1) {
        if (update.data === null) delete current[segments[0]];
        else current[segments[0]] = update.data;
      }
      state.firebaseCurrentStatus = current;
    }

    applyFirebaseStatus(state.firebaseCurrentStatus);
  }

  function renderFirebaseHistory(cloudUpdated = false) {
    const recordsBySequence = new Map();
    const history = Array.from(state.firebaseHistoryRecords.values())
      .map(validateHistoryRecord);
    const unsequencedHistory = [];
    for (const record of history) {
      if (record.deviceSequence === null) {
        unsequencedHistory.push(record);
      } else {
        recordsBySequence.set(record.deviceSequence, record);
      }
    }

    for (const record of state.bluetoothHistory) {
      if (record.deviceSequence === null) {
        unsequencedHistory.push(record);
      } else {
        const cloudRecord = recordsBySequence.get(record.deviceSequence);
        recordsBySequence.set(record.deviceSequence, cloudRecord
          ? { ...cloudRecord, elapsedMs: record.elapsedMs }
          : record);
      }
    }

    const mergedHistory = [...recordsBySequence.values(), ...unsequencedHistory];
    mergedHistory.sort((left, right) => {
      const leftTime = left.recordedAt ? Date.parse(left.recordedAt) : left.elapsedMs || 0;
      const rightTime = right.recordedAt ? Date.parse(right.recordedAt) : right.elapsedMs || 0;
      return rightTime - leftTime;
    });
    state.history = mergedHistory.slice(0, 500);
    if (cloudUpdated) state.historyApiState = 'online';
    renderHistory();
    renderDiagnostics();
  }

  function handleFirebaseHistoryEvent(event) {
    const update = JSON.parse(event.data);
    if (!update || typeof update.path !== 'string') {
      throw new Error('Firebase sent an invalid live history event.');
    }

    const segments = update.path.split('/').filter(Boolean);
    if (segments.length === 0) {
      if (event.type === 'put' || update.data === null) {
        state.firebaseHistoryRecords.clear();
      }
      if (update.data && typeof update.data === 'object') {
        for (const [key, record] of Object.entries(update.data)) {
          if (record === null) state.firebaseHistoryRecords.delete(key);
          else state.firebaseHistoryRecords.set(key, record);
        }
      }
    } else {
      const key = segments[0];
      if (segments.length === 1) {
        if (update.data === null) state.firebaseHistoryRecords.delete(key);
        else state.firebaseHistoryRecords.set(key, update.data);
      } else if (update.data === null) {
        state.firebaseHistoryRecords.delete(key);
      } else {
        const record = state.firebaseHistoryRecords.get(key) || {};
        let target = record;
        for (const segment of segments.slice(1, -1)) {
          target[segment] = target[segment] || {};
          target = target[segment];
        }
        target[segments[segments.length - 1]] = update.data;
        state.firebaseHistoryRecords.set(key, record);
      }
    }

    renderFirebaseHistory(true);
  }

  function startFirebaseListeners() {
    if (!IS_FIREBASE_CLOUD_PAGE || typeof EventSource !== 'function') return false;
    if (state.firebaseListenersStarted) return true;
    try {
      const databaseUrl = new URL(FIREBASE_DATABASE_URL);
      if (databaseUrl.protocol !== 'https:' || databaseUrl.username ||
          databaseUrl.password || databaseUrl.search || databaseUrl.hash) {
        return false;
      }
    } catch (_) {
      return false;
    }

    state.firebaseListenersStarted = true;
    state.connectionType = 'cloud';
    state.statusApiState = 'checking';
    state.historyApiState = 'checking';
    renderDiagnostics();

    state.firebaseStatusSource = new EventSource(
      `${FIREBASE_DATABASE_URL}/sensor/latest.json`,
    );
    state.firebaseHistorySource = new EventSource(
      getApiRequestUrl('/api/history', state.deviceUrl),
    );

    const attachStream = (source, handler, label, setStatus) => {
      for (const type of ['put', 'patch']) {
        source.addEventListener(type, (event) => {
          try {
            handler(event);
            if (state.statusApiState === 'online' &&
                state.historyApiState === 'online') {
              state.lastError = '';
            }
          } catch (error) {
            console.error(`Could not process Firebase ${label}:`, error);
            setStatus('error');
            state.lastError = `Firebase ${label}: ${describeConnectionError(error)}`;
            renderDiagnostics();
          }
        });
      }
      source.addEventListener('cancel', () => {
        setStatus('error');
        state.lastError = `Firebase ${label} stream was rejected by the database rules.`;
        renderDiagnostics();
      });
      source.onerror = () => {
        setStatus('error');
        state.lastError = `Firebase ${label} stream disconnected; waiting to reconnect.`;
        renderDiagnostics();
      };
    };

    attachStream(state.firebaseStatusSource, handleFirebaseStatusEvent, 'status', (value) => {
      state.statusApiState = value;
    });
    attachStream(state.firebaseHistorySource, handleFirebaseHistoryEvent, 'history', (value) => {
      state.historyApiState = value;
    });
    return true;
  }

  function describeConnectionError(error) {
    if (error && error.name === 'AbortError') {
      return IS_FIREBASE_CLOUD_PAGE
        ? 'Firebase did not respond in time. Check the internet connection and try again.'
        : 'The ESP32 did not respond in time. Check the Wi-Fi connection and try again.';
    }
    if (error instanceof TypeError) {
      return IS_FIREBASE_CLOUD_PAGE
        ? 'The browser could not reach Firebase Realtime Database. Check the internet connection and database rules.'
        : 'The browser could not reach the ESP32. If this page is hosted elsewhere, check that the ESP32 allows CORS requests.';
    }
    return error instanceof Error
      ? error.message
      : IS_FIREBASE_CLOUD_PAGE
        ? 'Could not load sensor data from Firebase.'
        : 'Could not load data from the ESP32.';
  }

  function getActiveWarning() {
    return state.warning || (!state.sensorOK
      ? 'The ESP32 reports that the sensor needs attention.'
      : '');
  }

  function vibrateForWarning() {
    if (typeof navigator.vibrate === 'function') {
      navigator.vibrate(10000);
    }
  }

  async function stopHardwareWarning() {
    if (IS_FIREBASE_CLOUD_PAGE || state.connectionType === 'bluetooth' || state.stoppingWarning ||
        state.warningSilenced || !state.connected || !getActiveWarning()) {
      return;
    }

    state.stoppingWarning = true;
    state.warningActionMessage = '';
    renderStatus();
    try {
      const response = await fetch(getApiRequestUrl('/api/warning/stop', state.deviceUrl), {
        method: 'POST',
        cache: 'no-store',
        headers: { Accept: 'application/json' },
      });
      if (!response.ok) {
        const detail = (await response.text()).trim().slice(0, 180);
        throw new Error(`HTTP ${response.status}${detail ? `: ${detail}` : ''}`);
      }

      state.warningSilenced = true;
      state.warningActionMessage = 'Hardware alarm silenced. Monitoring remains active.';
      if (typeof navigator.vibrate === 'function') {
        navigator.vibrate(0);
      }
    } catch (error) {
      console.error('Could not silence the hardware warning:', error);
      state.warningActionMessage = `Could not silence hardware alarm: ${describeConnectionError(error)}`;
    } finally {
      state.stoppingWarning = false;
      renderStatus();
    }
  }

  function applySensorStatus(status) {
    const hasValidReadings = typeof status?.temperature === 'number' &&
      Number.isFinite(status.temperature) &&
      typeof status?.humidity === 'number' &&
      Number.isFinite(status.humidity);
    const hasUnavailableReadings = status?.sensorOK === false &&
      status.temperature === null && status.humidity === null;
    if (!status || typeof status !== 'object' ||
        (!hasValidReadings && !hasUnavailableReadings)) {
      throw new Error('The monitor returned an invalid sensor status response.');
    }

    const previousWarningKey = state.activeWarningKey;
    state.temperature = hasValidReadings ? status.temperature : null;
    state.humidity = hasValidReadings ? status.humidity : null;
    state.sensorOK = status.sensorOK === true;
    if (typeof status.warning === 'string') {
      state.warning = status.warning.trim();
    } else if (status.warning === true) {
      state.warning = 'The hardware has reported a warning.';
    } else if (status.warning === false || status.warning == null) {
      state.warning = '';
    } else {
      throw new Error('The ESP32 returned an invalid hardware warning value.');
    }
    const activeWarning = getActiveWarning();
    if (activeWarning !== previousWarningKey) {
      state.warningSilenced = false;
      state.warningActionMessage = '';
      state.activeWarningKey = activeWarning;
      if (activeWarning && activeWarning !== WAITING_FOR_READING_MESSAGE) {
        vibrateForWarning();
      }
    }
    state.connected = true;
    if (status.recordedAt === undefined) {
      state.lastUpdated = new Date();
    } else {
      const recordedAt = new Date(status.recordedAt);
      state.lastUpdated = Number.isFinite(recordedAt.getTime()) ? recordedAt : null;
    }
    state.statusApiState = 'online';
    renderStatus();
    renderReadings();
  }

  async function connectBluetooth() {
    if (!navigator.bluetooth) {
      showMessage('Bluetooth is not available here. Open this page in Android Chrome over HTTPS.', 'error');
      return;
    }

    if (state.bluetoothDevice?.gatt?.connected) {
      state.bluetoothDevice.gatt.disconnect();
      return;
    }

    state.bluetoothReadyForReconnect = false;
    elements.bluetoothConnectButton.disabled = true;
    elements.bluetoothConnectButton.textContent = 'Connecting…';
    try {
      const device = await navigator.bluetooth.requestDevice({
        filters: [{ namePrefix: 'PoultryMonitor' }],
        optionalServices: [BLE_SERVICE_UUID],
      });
      device.addEventListener('gattserverdisconnected', () => {
        if (state.bluetoothDevice !== device) return;
        state.bluetoothDevice = null;
        state.bluetoothCharacteristic = null;
        state.bluetoothHistoryCharacteristic = null;
        state.bluetoothReadyForReconnect = true;
        state.connectionType = IS_FIREBASE_CLOUD_PAGE ? 'cloud' : 'network';
        state.connected = false;
        state.sensorOK = false;
        state.statusApiState = 'error';
        if (!IS_FIREBASE_CLOUD_PAGE) state.historyApiState = 'waiting';
        state.lastError = 'Bluetooth connection to the ESP32 was lost.';
        if (IS_FIREBASE_CLOUD_PAGE) renderFirebaseHistory();
        renderStatus();
        renderDiagnostics();
        if (IS_FIREBASE_CLOUD_PAGE) {
          startFirebaseListeners();
          refreshData();
        }
      }, { once: true });

      const server = await device.gatt.connect();
      const service = await server.getPrimaryService(BLE_SERVICE_UUID);
      state.bluetoothCharacteristic = await service.getCharacteristic(
        BLE_STATUS_CHARACTERISTIC_UUID,
      );
      try {
        state.bluetoothHistoryCharacteristic = await service.getCharacteristic(
          BLE_HISTORY_CHARACTERISTIC_UUID,
        );
      } catch (error) {
        console.warn('ESP32 Bluetooth history is unavailable; update the firmware to restore device history.', error);
        state.bluetoothHistoryCharacteristic = null;
      }
      state.bluetoothDevice = device;
      state.bluetoothReadyForReconnect = false;
      state.connectionType = 'bluetooth';
      state.bluetoothHistory = [];
      if (!IS_FIREBASE_CLOUD_PAGE) {
        state.history = [];
        state.historyApiState = state.bluetoothHistoryCharacteristic
          ? 'checking'
          : 'not-available';
      }
      state.lastError = '';
      renderHistory();
      await refreshData();
    } catch (error) {
      console.error('Could not connect to the ESP32 over Bluetooth:', error);
      const message = error?.name === 'NotFoundError'
        ? 'Bluetooth device selection was cancelled or the monitor was not found.'
        : error instanceof Error ? error.message : 'Could not connect to the ESP32 over Bluetooth.';
      state.lastError = message;
      state.statusApiState = 'error';
      state.historyApiState = 'not-available';
      elements.connectionMessage.textContent = message;
      renderDiagnostics();
    } finally {
      elements.bluetoothConnectButton.disabled = !navigator.bluetooth;
      renderStatus();
    }
  }

  async function refreshBluetoothData() {
    if (!state.bluetoothCharacteristic) return;
    if (state.refreshing) {
      state.refreshQueued = true;
      return;
    }
    state.refreshing = true;
    elements.refreshButton.classList.add('busy');
    elements.refreshButton.disabled = true;
    state.lastAttemptAt = new Date();
    state.statusApiState = 'checking';
    if (!IS_FIREBASE_CLOUD_PAGE) {
      state.historyApiState = state.bluetoothHistoryCharacteristic ? 'checking' : 'error';
    }
    state.lastError = '';
    renderDiagnostics();
    try {
      const value = await state.bluetoothCharacteristic.readValue();
      const status = JSON.parse(new TextDecoder().decode(value));
      applySensorStatus(status);
      if (state.bluetoothHistoryCharacteristic) {
        try {
          const historyValue = await state.bluetoothHistoryCharacteristic.readValue();
          const historyResponse = JSON.parse(new TextDecoder().decode(historyValue));
          if (!historyResponse || !Array.isArray(historyResponse.history)) {
            throw new Error('ESP32 returned an invalid Bluetooth history response.');
          }
          const bluetoothHistory = historyResponse.history.map((record) => {
            if (!Array.isArray(record) || (record.length !== 3 && record.length !== 4)) return record;
            return {
              temperature: record[0],
              humidity: record[1],
              elapsedMs: typeof record[2] === 'number' ? record[2] * 1000 : null,
              deviceSequence: Number.isSafeInteger(record[3]) ? record[3] : null,
            };
          }).map(validateHistoryRecord).reverse();
          state.bluetoothHistory = bluetoothHistory;
          if (!IS_FIREBASE_CLOUD_PAGE) state.historyApiState = 'online';
          if (IS_FIREBASE_CLOUD_PAGE) renderFirebaseHistory();
          else {
            state.history = bluetoothHistory;
            renderHistory();
          }
        } catch (error) {
          console.error('Could not restore sensor history over Bluetooth:', error);
          if (!IS_FIREBASE_CLOUD_PAGE) state.historyApiState = 'error';
          state.lastError = `Bluetooth history: ${describeConnectionError(error)}`;
        }
      } else {
        if (!IS_FIREBASE_CLOUD_PAGE) state.historyApiState = 'not-available';
      }
    } catch (error) {
      console.error('Could not read sensor status over Bluetooth:', error);
      state.connected = false;
      state.sensorOK = false;
      state.statusApiState = 'error';
      state.lastError = error instanceof Error
        ? `Bluetooth status: ${error.message}`
        : 'Could not read sensor status over Bluetooth.';
      elements.connectionMessage.textContent = state.lastError;
      renderStatus();
      renderReadings();
    } finally {
      renderHistory();
      renderDiagnostics();
      state.refreshing = false;
      elements.refreshButton.classList.remove('busy');
      elements.refreshButton.disabled = false;
      if (state.refreshQueued) {
        state.refreshQueued = false;
        window.setTimeout(refreshData, 0);
      }
    }
  }

  async function refreshData() {
    if (state.bluetoothCharacteristic) {
      await refreshBluetoothData();
      return;
    }
    if (IS_FIREBASE_CLOUD_PAGE) state.connectionType = 'cloud';

    if (state.refreshing) {
      state.refreshQueued = true;
      return;
    }

    const protocolMessage = getHttpsHttpMismatchMessage(state.deviceUrl);
    if (protocolMessage) {
      state.connected = false;
      state.sensorOK = false;
      state.statusApiState = 'error';
      state.historyApiState = 'error';
      state.lastAttemptAt = new Date();
      state.lastError = protocolMessage;
      renderStatus();
      elements.connectionMessage.textContent = protocolMessage;
      renderDiagnostics();
      return;
    }

    state.refreshing = true;
    elements.refreshButton.classList.add('busy');
    elements.refreshButton.disabled = true;
    const requestedUrl = state.deviceUrl;
    state.lastAttemptAt = new Date();
    state.statusApiState = 'checking';
    state.historyApiState = 'checking';
    state.lastError = '';
    renderDiagnostics();

    const errors = [];
    try {
      const status = await requestJson('/api/status', requestedUrl);
      if (requestedUrl !== state.deviceUrl) return;
      applySensorStatus(status);
    } catch (error) {
      console.error('Could not load sensor status:', error);
      if (requestedUrl === state.deviceUrl) {
        state.connected = false;
        state.sensorOK = false;
        state.warning = '';
        state.activeWarningKey = '';
        state.warningSilenced = false;
        state.warningActionMessage = '';
        state.statusApiState = 'error';
        errors.push(`Status endpoint: ${describeConnectionError(error)}`);
        renderStatus();
        elements.connectionMessage.textContent = describeConnectionError(error);
        renderReadings();
      }
    } finally {
      if (requestedUrl === state.deviceUrl) {
        try {
          const history = await requestJson('/api/history', requestedUrl);
          if (!history || !Array.isArray(history.history)) {
            throw new Error('The ESP32 returned an invalid history response.');
          }
          if (requestedUrl !== state.deviceUrl) return;
          if (IS_FIREBASE_CLOUD_PAGE) {
            state.firebaseHistoryRecords = new Map(
              history.history.map((record) => [record.firebaseKey, record]),
            );
            renderFirebaseHistory(true);
          } else {
            state.history = history.history.map(validateHistoryRecord);
            state.historyApiState = 'online';
            renderHistory();
          }
        } catch (error) {
          console.error('Could not load sensor history:', error);
          state.historyApiState = 'error';
          errors.push(`History endpoint: ${describeConnectionError(error)}`);
          elements.recentList.innerHTML = '<div class="empty-state">SQL history is temporarily unavailable. The live readings are still updating.</div>';
          elements.historyList.innerHTML = '<div class="empty-state">Could not load history from the local SQL database.</div>';
          elements.historyChart.innerHTML = '<div class="chart-empty">Could not load SQL history.</div>';
        }
        state.lastError = errors.join(' ');
        renderDiagnostics();
      }
      state.refreshing = false;
      elements.refreshButton.classList.remove('busy');
      elements.refreshButton.disabled = false;
      if (state.refreshQueued) {
        state.refreshQueued = false;
        window.setTimeout(refreshData, 0);
      }
    }
  }

  async function saveDeviceAddress(event) {
    event.preventDefault();
    const newUrl = normalizeUrl(elements.deviceUrlInput.value);
    if (!isValidDeviceUrl(newUrl)) {
      showMessage('Enter a valid base URL, for example http://192.168.4.1', 'error');
      elements.deviceUrlInput.focus();
      return;
    }

    state.deviceUrl = newUrl;
    elements.deviceUrlInput.value = newUrl;
    elements.sidebarAddress.textContent = newUrl.replace(/^https?:\/\//, '');
    elements.deviceAddressLabel.textContent = newUrl.replace(/^https?:\/\//, '');
    elements.saveButton.disabled = true;
    elements.saveButton.textContent = 'Saving…';

    try {
      localStorage.setItem(STORAGE_KEY, newUrl);
      showMessage('Address saved. Checking the ESP32 connection…', 'success');
    } catch (error) {
      console.error('Could not save the device address:', error);
      showMessage('Could not save settings in this browser. Check storage permissions.', 'error');
      elements.saveButton.disabled = false;
      elements.saveButton.innerHTML = 'Save & connect <svg><use href="#icon-arrow"></use></svg>';
      return;
    }

    await refreshData();
    elements.saveButton.disabled = false;
    elements.saveButton.innerHTML = 'Save & connect <svg><use href="#icon-arrow"></use></svg>';
    if (state.connected) {
      showMessage('Address saved and ESP32 connected.', 'success');
    } else {
      showMessage('Address saved, but the ESP32 is not reachable yet.', 'error');
    }
  }

  function initialize() {
    applyTheme(getSavedTheme());
    elements.deviceUrlInput.value = state.deviceUrl;
    elements.sidebarAddress.textContent = state.deviceUrl.replace(/^https?:\/\//, '');
    elements.deviceAddressLabel.textContent = state.deviceUrl.replace(/^https?:\/\//, '');

    $$('[data-page]').forEach((button) => {
      button.addEventListener('click', () => setPage(button.dataset.page));
    });
    $$('[data-page-link]').forEach((link) => {
      link.addEventListener('click', (event) => {
        event.preventDefault();
        setPage(link.dataset.pageLink);
      });
    });
    elements.refreshButton.addEventListener('click', refreshData);
    elements.bluetoothConnectButton.addEventListener('click', connectBluetooth);
    elements.stopWarningButton.addEventListener('click', stopHardwareWarning);
    elements.settingsForm.addEventListener('submit', saveDeviceAddress);
    elements.darkModeToggle.addEventListener('change', saveThemePreference);
    elements.installButton.addEventListener('click', installApp);

    setupProgressiveWebApp();
    const initialPage = window.location.hash.slice(1);
    setPage(pageInfo[initialPage] ? initialPage : 'home');
    renderStatus();
    renderReadings();
    renderHistory();
    startFirebaseListeners();
    refreshData();
    state.timer = window.setInterval(
      () => {
        if (state.bluetoothCharacteristic) {
          refreshData();
        } else if (state.firebaseListenersStarted) {
          renderStatus();
          renderReadings();
        } else {
          refreshData();
        }
      },
      REFRESH_INTERVAL_MS,
    );
  }

  initialize();
})();

)PMJS";

static const char DASHBOARD_MANIFEST[] PROGMEM = R"PMMANIFEST({
  "id": "./",
  "name": "Poultry House Monitor",
  "short_name": "Coop Care",
  "description": "Monitor poultry house temperature, humidity, and sensor health.",
  "start_url": "./",
  "scope": "./",
  "display": "standalone",
  "background_color": "#10191b",
  "theme_color": "#10191b",
  "categories": ["utilities"],
  "icons": [
    {
      "src": "./app-icon-192.png",
      "sizes": "192x192",
      "type": "image/png",
      "purpose": "any"
    },
    {
      "src": "./app-icon-512.png",
      "sizes": "512x512",
      "type": "image/png",
      "purpose": "any maskable"
    }
  ]
}
)PMMANIFEST";

static const unsigned char DASHBOARD_ICON_192[] PROGMEM = {
  0x89, 0x50, 0x4e, 0x47, 0x0d, 0x0a, 0x1a, 0x0a, 0x00, 0x00, 0x00, 0x0d, 0x49, 0x48, 0x44, 0x52,
  0x00, 0x00, 0x00, 0xc0, 0x00, 0x00, 0x00, 0xc0, 0x08, 0x06, 0x00, 0x00, 0x00, 0x52, 0xdc, 0x6c,
  0x07, 0x00, 0x00, 0x00, 0x01, 0x73, 0x52, 0x47, 0x42, 0x00, 0xae, 0xce, 0x1c, 0xe9, 0x00, 0x00,
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  0x82,
};

static const unsigned char DASHBOARD_ICON_512[] PROGMEM = {
  0x89, 0x50, 0x4e, 0x47, 0x0d, 0x0a, 0x1a, 0x0a, 0x00, 0x00, 0x00, 0x0d, 0x49, 0x48, 0x44, 0x52,
  0x00, 0x00, 0x02, 0x00, 0x00, 0x00, 0x02, 0x00, 0x08, 0x06, 0x00, 0x00, 0x00, 0xf4, 0x78, 0xd4,
  0xfa, 0x00, 0x00, 0x00, 0x01, 0x73, 0x52, 0x47, 0x42, 0x00, 0xae, 0xce, 0x1c, 0xe9, 0x00, 0x00,
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  0x4e, 0x44, 0xae, 0x42, 0x60, 0x82,
};
